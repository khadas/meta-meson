## conf/machine/mesons4d-aq2432-common.inc
```bitbake
#@TYPE: Machine
#@NAME: meson

#@DESCRIPTION: Machine configuration for meson systems

include conf/machine/include/mesons4_k5.4_32b.inc
include conf/machine/mesons4-westeros.inc

CHIPSET_NAME = "S805C3"
UBOOT_MACHINE = "s4_aq2432_config"
#Default is EMMC
KERNEL_DEVICETREE = "s4d_s805c3_aq2432_linux_512m.dtb"

MACHINE_EXTRA_RRECOMMENDS:remove = " wififw-qca6174 qca6174"
KERNEL_MODULE_AUTOLOAD:remove = " btqca "
KERNEL_MODULE_PROBECONF:remove = " btqca "
KERNEL_MODULE_AUTOLOAD:remove = " hci_uart"
KERNEL_MODULE_PROBECONF:remove = "hci_uart"

MACHINE_EXTRA_RRECOMMENDS:append = " aml-wifi-w1"

DISTRO_FEATURES:remove = " bt-qca "
DISTRO_FEATURES:append = " aml-w1 aml-wifi "
DISTRO_FEATURES:remove = " netflix amazon tts mediaplayer playready "
DISTRO_FEATURES:remove = " bluetooth bluez5 "

DISTRO_FEATURES:append = " UI_720P low-memory"
DISTRO_FEATURES:append = " appmanager aamp"
DISTRO_FEATURES:append = " arka use-egl arka-project-aml"
DISTRO_FEATURES:append = " webkitbrowser"
DISTRO_FEATURES:append = " fota-upgrade swupdate-download"
DISTRO_FEATURES:append = " remove-test-files"

SYSTEM_DM_VERITY_IMAGE = "${@bb.utils.contains('MULTILIBS', 'multilib:lib32', 'lib32-amlogic-zapperplus', 'amlogic-zapperplus', d)}"

OVERRIDES .= ":aq2432"
TDK_VERSION:s4 = "v3.8/dev/S805C3"

ZRAM_FRACTION = "35"

# For Fota upgrade
DEVICE_PROPERTY_DEVINFO_OEM = "Amlogic"
DEVICE_PROPERTY_DEVINFO_DEVICETYPE = "smarthome"
DEVICE_PROPERTY_DEVINFO_PLATFORM = "A113D"
DEVICE_PROPERTY_DEVINFO_MODELS = "OTT"
DEVICE_PROPERTY_DEVINFO_PRODUCTID = "1660115992"
DEVICE_PROPERTY_DEVINFO_PRODUCTSECRET = "fa7bfc8d755c4c0b8c52fdb00d431d3f"
# End For Fota upgrade

# For YouTube Cert. Now it's for 2024
DEVICE_PROPERTY_FIRMWARE_VERSION = "1.0.0"
DEVICE_PROPERTY_MODEL_NAME = "ZapperPlus"
DEVICE_PROPERTY_OPERATOR_NAME = "SDKRelease"
DEVICE_PROPERTY_YOUTUBE_CERT_SCOPE = "amlogic-2024-zapperplus2024"
DEVICE_PROPERTY_PERSIST_DIALSERVER_NAME="ZapperPlus"
# YouTube define device type
# BDP:   Blu-Ray Player
# GAME:  Game Console
# OTT:   Over-The-Top Device
# STB:   Set-Top-Box, which includes a tuner and demodulator
# TV:    Television Set
DEVICE_PROPERTY_DEVICE_TYPE = "STB"
DEVICE_PROPERTY_CHIPSET = "S805C3"
DEVICE_PROPERTY_MODEL_YEAR = "2024"
DEVICE_PROPERTY_PERSIST_YOUTUBE_FORCE_4K = "n"
DEVICE_PROPERTY_PERSIST_YOUTUBE_MICROPHONE_ENABLED = "n"
DEVICE_PROPERTY_PERSIST_YOUTUBE_TOTAL_CPU_MEMORY = "0xAA00000"
DEVICE_PROPERTY_PERSIST_YOUTUBE_GST_APPSRC_VIDEO_SIZE = "0x400000"
DEVICE_PROPERTY_PERSIST_YOUTUBE_GST_APPSRC_AUDIO_SIZE = "0x100000"
DEVICE_PROPERTY_PERSIST_YOUTUBE_VIDEOSINK_LOWMEM = "y"
DEVICE_PROPERTY_PERSIST_YOUTUBE_SECMEM_SIZE_THRESHOLD = "0x20000"
DEVICE_PROPERTY_PERSIST_YOUTUBE_AUDIO_BUFFERING_LOW_LEVEL = "150000000"
DEVICE_PROPERTY_PERSIST_YOUTUBE_AUDIO_BUFFERING_HIGH_LEVEL = "350000000"
DEVICE_PROPERTY_PERSIST_YOUTUBE_VIDEO_BUFFERING_LOW_LEVEL = "150000000"
DEVICE_PROPERTY_PERSIST_YOUTUBE_VIDEO_BUFFERING_HIGH_LEVEL = "350000000"
DEVICE_PROPERTY_PERSIST_YOUTUBE_VIDEO_MAXBUF_FHD = "0x1900000"
DEVICE_PROPERTY_PERSIST_YOUTUBE_MEDIA_MAXBUF_FHD = "0x2800000"
# End For YouTube

DEVICE_PROPERTY_LAUNCHER_APPS = "arka, youtube, youtubetv, youtubekids"
DEVICE_PROPERTY_STARTUP_APP = "arka"
```

## conf/machine/mesons4d-aq2432-irdeto.conf
```bitbake
include conf/machine/mesons4d-aq2432-common.inc

DISTRO_FEATURES_append = " irdeto "

# AVB and chained partition
DISTRO_FEATURES_append = " AVB READONLY dm-verity AVB_chained_partition "
DEVICE_PROPERTY_BOOT_PARTITION_SIZE = "0x4000000"
DEVICE_PROPERTY_VBMETA_ROLLBACK_INDEX = "0"
DEVICE_PROPERTY_SYSTEM_ROLLBACK_LOCATION = "1"
DEVICE_PROPERTY_VENDOR_ROLLBACK_LOCATION = "2"
# For AVB2 chained partition, the actual signing and root hash information
# are stored in the AVB2 footer of the partition
# Libavb in U-Boot will look at the end of the partition to look for footer.
# Therefore, exact size of the partition has to be specified.
DEVICE_PROPERTY_SYSTEM_PARTITION_SIZE = "0x60000000"
DEVICE_PROPERTY_VENDOR_PARTITION_SIZE = "0x1C000000"
DISTRO_FEATURES_append = " recovery AVB_recovery_partition "
DEVICE_PROPERTY_RECOVERY_ROLLBACK_LOCATION = "3"
DEVICE_PROPERTY_RECOVERY_PARTITION_SIZE = "0x2000000"
# Rollback indexes for system and vendor are supported only if chained
DEVICE_PROPERTY_SYSTEM_ROLLBACK_INDEX = "0"
DEVICE_PROPERTY_VENDOR_ROLLBACK_INDEX = "0"
# For recovery, it is always chained if enabled.
DEVICE_PROPERTY_RECOVERY_ROLLBACK_INDEX = "0"
```

## conf/machine/mesons4d-aq2432-nand-irdeto.conf
```bitbake
include conf/machine/mesons4d-aq2432-common.inc

KERNEL_DEVICETREE = "s4d_s805c3_aq2432_512m.dtb s4d_s805c3_t215_512m.dtb"

DISTRO_FEATURES_append = " irdeto "
DISTRO_FEATURES_append = " nand "
ROOTFS_TYPE = "squashfs"
DM_VERITY_IMAGE_TYPE = "squashfs"

# AVB and chained partition
DISTRO_FEATURES_append = " AVB dm-verity AVB_chained_partition "
DEVICE_PROPERTY_BOOT_PARTITION_SIZE = "0x2200000"
DEVICE_PROPERTY_VBMETA_ROLLBACK_INDEX = "0"
DEVICE_PROPERTY_SYSTEM_ROLLBACK_LOCATION = "1"
DEVICE_PROPERTY_VENDOR_ROLLBACK_LOCATION = "2"
# For AVB2 chained partition, the actual signing and root hash information
# are stored in the AVB2 footer of the partition
# Libavb in U-Boot will look at the end of the partition to look for footer.
# Therefore, exact size of the partition has to be specified.
DEVICE_PROPERTY_SYSTEM_PARTITION_SIZE = "0xE000000"
DEVICE_PROPERTY_VENDOR_PARTITION_SIZE = "0x1000000"
DISTRO_FEATURES_append = " recovery AVB_recovery_partition "
DEVICE_PROPERTY_RECOVERY_ROLLBACK_LOCATION = "3"
DEVICE_PROPERTY_RECOVERY_PARTITION_SIZE = "0x2000000"
# Rollback indexes for system and vendor are supported only if chained.
# Nand cannot support AVB rollback index due to lack of rpmb support.
# The configuration is just for passing compilation and has no effect on the system.
DEVICE_PROPERTY_SYSTEM_ROLLBACK_INDEX = "0"
DEVICE_PROPERTY_VENDOR_ROLLBACK_INDEX = "0"
# For recovery, it is always chained if enabled.
DEVICE_PROPERTY_RECOVERY_ROLLBACK_INDEX = "0"
```

## conf/machine/mesons4d-aq2432-zapper-irdeto.conf
```bitbake
#@TYPE: Machine
#@NAME: meson

#@DESCRIPTION: Machine configuration for meson systems

include conf/machine/include/mesons4_k5.4_32b.inc
include conf/machine/include/amlogic_nogpu.inc


MACHINE_ESSENTIAL_EXTRA_RRECOMMENDS += " \
        aucpu-fw \
        tuner-prebuilt \
        "

CHIPSET_NAME = "S805C3"
KERNEL_DEVICETREE = "s4d_s805c3_aq2432_256m.dtb s4d_s805c3_t215_256m.dtb"
#KERNEL_DEVICETREE = "s4d_s805c3_aq2432_512m.dtb s4d_s805c3_t215_512m.dtb"
UBOOT_MACHINE = "s4_aq2432_config"

DISTRO_FEATURES:append = " nand"
DISTRO_FEATURES:append = " irdeto "
ROOTFS_TYPE = "squashfs"

KERNEL_MODULE_AUTOLOAD += " snd-soc-dummy_codec"
KERNEL_MODULE_AUTOLOAD += " snd-soc-aml_t9015"
KERNEL_MODULE_AUTOLOAD += " meson_ir"
KERNEL_MODULE_AUTOLOAD += " aml_aucpu"
KERNEL_MODULE_AUTOLOAD += " meson-cpufreq"
KERNEL_MODULE_AUTOLOAD += " media_sync"
KERNEL_MODULE_AUTOLOAD += " cxd2856_fe_32 r836_fe_32 av2018_fe_32 "

DISTRO_FEATURES:append = " secure-u-boot optee "
DISTRO_FEATURES:append = " alsa "
DISTRO_FEATURES_BACKFILL_CONSIDERED = "sysvinit"
DEFAULT_DISTRO_FEATURES += " systemd"
DISTRO_FEATURES:append = " systemd"
DISTRO_FEATURES:append = " aml-dtv "
DISTRO_FEATURES:append = " amlogic-dvb "
DISTRO_FEATURES:append = " recovery "
DISTRO_FEATURES:append = " zapper "
DISTRO_FEATURES:append = " zapper-reference "
DISTRO_FEATURES:append = " dfb "
DISTRO_FEATURES:append = " swupdate "
DISTRO_FEATURES:append = " swupdate-dvb-ota "

DISTRO_FEATURES:remove = " vendor-partition"
DISTRO_FEATURES:remove = " sysvinit"
DISTRO_FEATURES:remove = " bluetooth wifi ipv6 ipvsec nfc nfs 3g smbfs ppp zeroconf "
DISTRO_FEATURES:remove = " acl xattr pam selinux"

MACHINE_FEATURES:remove = " phone pci pcmcia "

TDK_VERSION:s4 = "v3.8/dev/S805C3"
OVERRIDES .= ":aq2432"
MACHINEOVERRIDES .= ":client"
```

## conf/machine/mesons4d-aq2432-zapper-k515-irdeto.conf
```bitbake
#@TYPE: Machine
#@NAME: meson

#@DESCRIPTION: Machine configuration for meson systems

include conf/machine/include/mesons4_k5.15_32b.inc
include conf/machine/include/amlogic_nogpu.inc


MACHINE_ESSENTIAL_EXTRA_RRECOMMENDS += " \
        aucpu-fw \
        tuner-prebuilt \
        "

CHIPSET_NAME = "S805C3"
KERNEL_DEVICETREE = "s4d_s805c3_aq2432_256m.dtb s4d_s805c3_t215_256m.dtb"
#KERNEL_DEVICETREE = "s4d_s805c3_aq2432_512m.dtb s4d_s805c3_t215_512m.dtb"
UBOOT_MACHINE = "s4_aq2432_config"

DISTRO_FEATURES_append = " kernel_515"
DISTRO_FEATURES_append = " nand"
DISTRO_FEATURES_append = " irdeto "
ROOTFS_TYPE = "squashfs"

KERNEL_MODULE_AUTOLOAD += " amlogic-fs-yaffs"
KERNEL_MODULE_AUTOLOAD += " amlogic-socinfo"
KERNEL_MODULE_AUTOLOAD += " amlogic-snd-soc"
KERNEL_MODULE_AUTOLOAD += " amlogic-snd-codec-t9015"
KERNEL_MODULE_AUTOLOAD += " cxd2856_fe_32 r836_fe_32 av2018_fe_32 "

DISTRO_FEATURES_append = " secure-u-boot optee "
DISTRO_FEATURES_append = " alsa "
DISTRO_FEATURES_BACKFILL_CONSIDERED = "sysvinit"
DEFAULT_DISTRO_FEATURES += " systemd"
DISTRO_FEATURES_append = " systemd"
DISTRO_FEATURES_append = " aml-dtv "
DISTRO_FEATURES_append = " amlogic-dvb "
DISTRO_FEATURES_append = " zapper "
DISTRO_FEATURES_append = " zapper-reference "
DISTRO_FEATURES_append = " dfb "
DISTRO_FEATURES_append = " swupdate "

DISTRO_FEATURES_remove = " sysvinit"
DISTRO_FEATURES_remove = " bluetooth wifi ipv6 ipvsec nfc nfs 3g smbfs ppp zeroconf "
DISTRO_FEATURES_remove = " acl xattr pam selinux"

MACHINE_FEATURES_remove = " phone pci pcmcia "

TDK_VERSION_s4 = "v3.8/dev/S805C3"
OVERRIDES .= ":aq2432"
MACHINEOVERRIDES .= ":client"
```

## conf/machine/mesons4d-aq2432-zapper-sysv-irdeto.conf
```bitbake
#@TYPE: Machine
#@NAME: meson

#@DESCRIPTION: Machine configuration for meson systems

include conf/machine/include/mesons4_k5.15_32b.inc
include conf/machine/include/amlogic_nogpu.inc


MACHINE_ESSENTIAL_EXTRA_RRECOMMENDS += " \
        aucpu-fw \
        tuner-prebuilt \
        "

CHIPSET_NAME = "S805C3"
KERNEL_DEVICETREE = "s4d_s805c3_aq2432_256m.dtb s4d_s805c3_t215_256m.dtb"
#KERNEL_DEVICETREE = "s4d_s805c3_aq2432_512m.dtb s4d_s805c3_t215_512m.dtb"
UBOOT_MACHINE = "s4_aq2432_config"

DISTRO_FEATURES:append = " kernel_515"
DISTRO_FEATURES:append = " nand"
DISTRO_FEATURES:append = " irdeto "
ROOTFS_TYPE = "squashfs"

KERNEL_MODULE_AUTOLOAD += " amlogic-fs-yaffs"
KERNEL_MODULE_AUTOLOAD += " amlogic-socinfo"
KERNEL_MODULE_AUTOLOAD += " amlogic-snd-soc"
KERNEL_MODULE_AUTOLOAD += " amlogic-snd-codec-t9015"
KERNEL_MODULE_AUTOLOAD += " cxd2856_fe_32 r836_fe_32 av2018_fe_32 "

DISTRO_FEATURES:append = " secure-u-boot optee "
DISTRO_FEATURES:append = " alsa "
DISTRO_FEATURES:append = " aml-dtv "
DISTRO_FEATURES:append = " amlogic-dvb "
DISTRO_FEATURES:append = " recovery "
DISTRO_FEATURES:append = " zapper "
DISTRO_FEATURES:append = " zapper-reference "
DISTRO_FEATURES:append = " aml-SUB-FB "
DISTRO_FEATURES:append = " dfb "
DISTRO_FEATURES:append = " swupdate "
DISTRO_FEATURES:append = " swupdate-dvb-ota "
DISTRO_FEATURES:append = " arka "

DISTRO_FEATURES:remove = " vendor-partition"
DISTRO_FEATURES:remove = " bluetooth wifi ipv6 ipvsec nfc nfs 3g smbfs ppp zeroconf "
DISTRO_FEATURES:remove = " acl xattr pam selinux"

MACHINE_FEATURES:remove = " phone pci pcmcia "

TDK_VERSION:s4 = "v3.8/dev/S805C3"
OVERRIDES .= ":aq2432"
MACHINEOVERRIDES .= ":client"

# Use sysvinit for system initialization
DISTRO_FEATURES:append = " sysvinit"
DISTRO_FEATURES_BACKFILL_CONSIDERED:append = " systemd"
VIRTUAL-RUNTIME_init_manager = "sysvinit"
VIRTUAL-RUNTIME_initscripts = "initscripts"
VIRTUAL-RUNTIME_login_manager = "busybox"
```
