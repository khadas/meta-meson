## conf/machine/mesons4-aq223-weston.conf
```bitbake
#@TYPE: Machine
#@NAME: meson

#@DESCRIPTION: Machine configuration for meson systems

include conf/machine/include/mesons4_k5.4_32b.inc
#include conf/machine/include/mesons4_k5.4_64b.inc

include conf/machine/mesons4-aq222-weston.inc

KERNEL_MODULE_AUTOLOAD += " hdr10_tmo_alg_32"

MACHINE_EXTRA_RRECOMMENDS_remove = " wififw-qca6174 qca6174"
KERNEL_MODULE_AUTOLOAD_remove = " btqca "
KERNEL_MODULE_PROBECONF_remove = " btqca "

MACHINE_EXTRA_RRECOMMENDS_append = " aml-wifi-w1 aml-bt-w1"
DISTRO_FEATURES_append = " aml-w1 "
```

## conf/machine/mesons4-aq223.conf
```bitbake
#@TYPE: Machine
#@NAME: meson

#@DESCRIPTION: Machine configuration for meson systems

include conf/machine/include/mesons4_k5.4_32b.inc
#include conf/machine/include/mesons4_k5.4_64b.inc

include conf/machine/mesons4-westeros.inc

CHIPSET_NAME = "S805X2"
KERNEL_DEVICETREE = "s4_s805x2_aq222_linux_1g.dtb"
UBOOT_MACHINE = "s4_aq222_config"

OVERRIDES .= ":aq222"
TDK_VERSION:s4 = "v3.8/dev/S805X2"

MACHINE_EXTRA_RRECOMMENDS:remove = " wififw-qca6174 qca6174"
KERNEL_MODULE_AUTOLOAD:remove = " btqca "
KERNEL_MODULE_PROBECONF:remove = " btqca "

MACHINE_EXTRA_RRECOMMENDS:append = " aml-wifi-w1 aml-bt-w1"
DISTRO_FEATURES:remove = " bt-qca "
DISTRO_FEATURES:append = " aml-w1 "
```

## conf/machine/mesons4-lib32-ap222-k5.15.conf
```bitbake
#@TYPE: Machine
#@NAME: meson

#@DESCRIPTION: Machine configuration for meson systems

include conf/machine/include/mesons4_k5.15_64b.inc

include conf/machine/mesons4-ap222-common.inc
```

## conf/machine/mesons4-lib32-ap222-nand.conf
```bitbake
#@TYPE: Machine
#@NAME: meson

#@DESCRIPTION: Machine configuration for meson systems

include conf/machine/mesons4-lib32-ap222.conf

KERNEL_DEVICETREE = "s4_s905y4_ap222_linux-nand.dtb"
DISTRO_FEATURES:append = " nand"
ROOTFS_TYPE = "ubifs"

DISTRO_FEATURES:remove = " amazon netflix"
DEVICE_PROPERTY_BOOT_PARTITION_SIZE = "0x2000000"
DEVICE_PROPERTY_VBMETA_ROLLBACK_INDEX = "0"
DEVICE_PROPERTY_RECOVERY_PARTITION_SIZE = "0x2800000"
DEVICE_PROPERTY_RECOVERY_ROLLBACK_LOCATION = "31"
DEVICE_PROPERTY_RECOVERY_ROLLBACK_INDEX = "0"
```

## conf/machine/mesons4d-ap223.conf
```bitbake
include conf/machine/include/mesons4_k5.4_32b.inc
include conf/machine/include/amlogic_westeros.inc

PREFERRED_PROVIDER_virtual/mesa = "libgles-eabihf-dvalin-wayland-drm"
PREFERRED_PROVIDER_virtual/mesa-gl = "libgles-eabihf-dvalin-wayland-drm"
PREFERRED_PROVIDER_virtual/libgbm = "libgles-eabihf-dvalin-wayland-drm"
PREFERRED_PROVIDER_virtual/egl = "libgles-eabihf-dvalin-wayland-drm"
PREFERRED_PROVIDER_virtual/libgl = "libgles-eabihf-dvalin-wayland-drm"
PREFERRED_PROVIDER_virtual/libgles1 = "libgles-eabihf-dvalin-wayland-drm"
PREFERRED_PROVIDER_virtual/libgles2 = "libgles-eabihf-dvalin-wayland-drm"

MACHINE_EXTRA_RRECOMMENDS += " \
        rtk8822cs \
        realtek-btuart \
        realtek-btusb \
        realtek-hciattach \
        pq-prebuilt \
        aucpu-fw \
        gpu \
        "

CHIPSET_NAME = "S905Y4"
KERNEL_DEVICETREE = "s4d_s905y4_ap223_linux.dtb"
UBOOT_MACHINE = "s4_ap223_config"
KERNEL_MODULE_AUTOLOAD += " hdr10_tmo_alg_32"
KERNEL_MODULE_AUTOLOAD += " snd-soc-dummy_codec"
KERNEL_MODULE_AUTOLOAD += " snd-soc-aml_t9015"
KERNEL_MODULE_AUTOLOAD += " snd_soc"
KERNEL_MODULE_AUTOLOAD += " snd_soc_notify"
KERNEL_MODULE_AUTOLOAD += " meson_ir"
KERNEL_MODULE_AUTOLOAD += " aml_aucpu"
KERNEL_MODULE_AUTOLOAD += " dolby_fw"
KERNEL_MODULE_AUTOLOAD += " meson-cpufreq"

DISTRO_FEATURES:append = " drm"
#DISTRO_FEATURES:append = " onepass"
DISTRO_FEATURES:append = " secure-u-boot optee "
#DISTRO_FEATURES:append = " absystem"
DISTRO_FEATURES:append = " widevine "
DISTRO_FEATURES:append = " playready "
#DISTRO_FEATURES:remove = " alsa "
DISTRO_FEATURES:append = " alsa "
DISTRO_FEATURES:append = " pam"
DISTRO_FEATURES_BACKFILL_CONSIDERED = "sysvinit"
DEFAULT_DISTRO_FEATURES += " systemd"
DISTRO_FEATURES:append = " systemd"
DISTRO_FEATURES:remove = " sysvinit"
#DISTRO_FEATURES:append = " opengl"
DISTRO_FEATURES:append = " gstreamer1"
#DISTRO_FEATURES:append = " AVB "
DISTRO_FEATURES:append = " recovery "
DISTRO_FEATURES:append = " swupdate "

OVERRIDES .= ":ap223:s4:onepass"
MACHINEOVERRIDES .= ":client"

DISTRO_FEATURES:append = " bluetooth bluez5 "
EXTRA_BLUETOOTH_STUFF := "${@bb.utils.contains('DISTRO_FEATURES', 'bluetooth', bb.utils.contains('DISTRO_FEATURES', 'bluez5', ' bluez5', ' bluez4', d), '', d)}"
DISTRO_FEATURES:append = "${EXTRA_BLUETOOTH_STUFF}"

TDK_VERSION:s4 = "v3.8/dev/S905Y4"

# For YouTube Cert. Now it's for 2023
DEVICE_PROPERTY_FIRMWARE_VERSION = "1.0.0"
DEVICE_PROPERTY_MODEL_NAME = "OTT-4K-Ref"
DEVICE_PROPERTY_OPERATOR_NAME = "SDKRelease"
DEVICE_PROPERTY_YOUTUBE_CERT_SCOPE = "amlogic-2023-amlogicottref4k2023"
DEVICE_PROPERTY_PERSIST_DIALSERVER_NAME="AmlogicOTT-AP223"
# YouTube define device type
# BDP:   Blu-Ray Player
# GAME:  Game Console
# OTT:   Over-The-Top Device
# STB:   Set-Top-Box, which includes a tuner and demodulator
# TV:    Television Set
DEVICE_PROPERTY_DEVICE_TYPE = "OTT"
DEVICE_PROPERTY_CHIPSET = "S905Y4"
DEVICE_PROPERTY_MODEL_YEAR = "2023"
# End For YouTube

# For amazon
DEVICE_PROPERTY_AMAZON_DTID = "A3SJQCMWSDF1EG"
```

## conf/machine/mesons4d-ap232-irdeto.conf
```bitbake
include conf/machine/include/mesons4_k5.4_32b.inc
include conf/machine/mesons4d-ap232.inc

DISTRO_FEATURES:append = " irdeto "

# AVB and chained partition
DISTRO_FEATURES:append = " AVB dm-verity AVB_chained_partition "
DEVICE_PROPERTY_BOOT_PARTITION_SIZE = "0x4000000"
DEVICE_PROPERTY_VBMETA_ROLLBACK_INDEX = "0"
DEVICE_PROPERTY_SYSTEM_ROLLBACK_LOCATION = "1"
DEVICE_PROPERTY_VENDOR_ROLLBACK_LOCATION = "2"
# For AVB2 chained partition, the actual signing and root hash information
# are stored in the AVB2 footer of the partition
# Libavb in U-Boot will look at the end of the partition to look for footer.
# Therefore, exact size of the partition has to be specified.
DEVICE_PROPERTY_SYSTEM_PARTITION_SIZE = "0x60000000"
DEVICE_PROPERTY_VENDOR_PARTITION_SIZE = "0x1C000000"
# Rollback indexes for system and vendor are supported only if chained
DEVICE_PROPERTY_SYSTEM_ROLLBACK_INDEX = "0"
DEVICE_PROPERTY_VENDOR_ROLLBACK_INDEX = "0"

# Recovery partition is verified standalone just like vbmeta
DEVICE_PROPERTY_RECOVERY_PARTITION_SIZE = "0x2000000"
DEVICE_PROPERTY_RECOVERY_ROLLBACK_LOCATION = "31"
DEVICE_PROPERTY_RECOVERY_ROLLBACK_INDEX = "0"
```

## conf/machine/mesons4d-ap232-k5.15.conf
```bitbake
include conf/machine/include/mesons4_k5.15_32b.inc
include conf/machine/mesons4d-ap232.inc
```

## conf/machine/mesons4d-ap232-nand.conf
```bitbake
include conf/machine/include/mesons4_k5.4_32b.inc
include conf/machine/mesons4d-ap232.inc

KERNEL_DEVICETREE = "s4d_s905c3_ap232_linux-nand.dtb"

DISTRO_FEATURES:append = " nand"
ROOTFS_TYPE = "ubifs"
DISTRO_FEATURES:remove = " amazon netflix"
```

## conf/machine/mesons4d-ap232-zapper.conf
```bitbake
#@TYPE: Machine
#@NAME: meson

#@DESCRIPTION: Machine configuration for meson systems

include conf/machine/include/mesons4_k5.4_32b.inc
include conf/machine/include/amlogic_nogpu.inc

MACHINE_ESSENTIAL_EXTRA_RRECOMMENDS += " \
        aucpu-fw \
        tuner-prebuilt \
        "

CHIPSET_NAME = "S905C3"
KERNEL_DEVICETREE = "s4d_s905c3_ap232_linux.dtb"
UBOOT_MACHINE = "s4_ap232_config"
KERNEL_MODULE_AUTOLOAD += " snd-soc-dummy_codec"
KERNEL_MODULE_AUTOLOAD += " snd-soc-aml_t9015"
KERNEL_MODULE_AUTOLOAD += " meson_ir"
KERNEL_MODULE_AUTOLOAD += " aml_aucpu"
KERNEL_MODULE_AUTOLOAD += " meson-cpufreq"
KERNEL_MODULE_AUTOLOAD += " media_sync"
KERNEL_MODULE_AUTOLOAD += " cxd2856_fe_32 r836_fe_32 av2018_fe_32 "
KERNEL_MODULE_AUTOLOAD += " hdr10_tmo_alg_32"

DISTRO_FEATURES:append = " secure-u-boot optee "
DISTRO_FEATURES:append = " alsa "
DISTRO_FEATURES_BACKFILL_CONSIDERED = "sysvinit"
DEFAULT_DISTRO_FEATURES += " systemd"
DISTRO_FEATURES:append = " systemd"
DISTRO_FEATURES:append = " aml-dtv "
DISTRO_FEATURES:append = " amlogic-dvb "
DISTRO_FEATURES:append = " recovery "
DISTRO_FEATURES:append = " aml-SUB-DFB "
DISTRO_FEATURES:append = " dfb "
DISTRO_FEATURES:append = " swupdate "

DISTRO_FEATURES:remove = " sysvinit"
DISTRO_FEATURES:remove = " bluetooth wifi ipv6 ipvsec nfc nfs 3g smbfs ppp zeroconf "
DISTRO_FEATURES:remove = " acl xattr pam selinux"

MACHINE_FEATURES:remove = " phone pci pcmcia "

OVERRIDES .= ":ap222:ap232:s4:onepass"
MACHINEOVERRIDES .= ":client"

TDK_VERSION:s4 = "v3.8/dev/S905C3"
```

## conf/machine/mesons4d-ap232.conf
```bitbake
include conf/machine/include/mesons4_k5.4_32b.inc
include conf/machine/mesons4d-ap232.inc

DISTRO_FEATURES:append = " AVB "
DEVICE_PROPERTY_BOOT_PARTITION_SIZE = "0x4000000"
DEVICE_PROPERTY_VBMETA_ROLLBACK_INDEX = "0"

# Recovery partition is verified standalone just like vbmeta
DEVICE_PROPERTY_RECOVERY_PARTITION_SIZE = "0x2000000"
DEVICE_PROPERTY_RECOVERY_ROLLBACK_LOCATION = "31"
DEVICE_PROPERTY_RECOVERY_ROLLBACK_INDEX = "0"
```

## conf/machine/mesons4d-ap232.inc
```bitbake
include conf/machine/include/amlogic_westeros.inc

PREFERRED_PROVIDER_virtual/mesa = "libgles-eabihf-dvalin-wayland-drm"
PREFERRED_PROVIDER_virtual/mesa-gl = "libgles-eabihf-dvalin-wayland-drm"
PREFERRED_PROVIDER_virtual/libgbm = "libgles-eabihf-dvalin-wayland-drm"
PREFERRED_PROVIDER_virtual/egl = "libgles-eabihf-dvalin-wayland-drm"
PREFERRED_PROVIDER_virtual/libgl = "libgles-eabihf-dvalin-wayland-drm"
PREFERRED_PROVIDER_virtual/libgles1 = "libgles-eabihf-dvalin-wayland-drm"
PREFERRED_PROVIDER_virtual/libgles2 = "libgles-eabihf-dvalin-wayland-drm"

MACHINE_EXTRA_RRECOMMENDS += " \
        wififw-qca6174 \
        qca6174 \
        pq-prebuilt \
        tuner-prebuilt \
        aucpu-fw \
        gpu \
        "

CHIPSET_NAME = "S905C3"
KERNEL_DEVICETREE = "s4d_s905c3_ap232_linux.dtb"
UBOOT_MACHINE = "s4_ap232_config"
KERNEL_MODULE_AUTOLOAD += " cxd2856_fe_32 r836_fe_32 av2018_fe_32 "
KERNEL_MODULE_AUTOLOAD += " hdr10_tmo_alg_32"
KERNEL_MODULE_AUTOLOAD += " snd-soc-dummy_codec"
KERNEL_MODULE_AUTOLOAD += " snd-soc-aml_t9015"
KERNEL_MODULE_AUTOLOAD += " snd_soc"
KERNEL_MODULE_AUTOLOAD += " snd_soc_notify"
KERNEL_MODULE_AUTOLOAD += " meson_ir"
KERNEL_MODULE_AUTOLOAD += " btqca"
KERNEL_MODULE_PROBECONF += "btqca"
KERNEL_MODULE_AUTOLOAD += " hci_uart"
KERNEL_MODULE_PROBECONF += "hci_uart"
KERNEL_MODULE_AUTOLOAD += "aml_aucpu"
KERNEL_MODULE_AUTOLOAD += "dolby_fw"
KERNEL_MODULE_AUTOLOAD += "meson-cpufreq"

DISTRO_FEATURES:append = " drm"
#DISTRO_FEATURES:append = " onepass"
DISTRO_FEATURES:append = " secure-u-boot optee "
#DISTRO_FEATURES:append = " absystem"
DISTRO_FEATURES:append = " widevine "
DISTRO_FEATURES:append = " playready "
DISTRO_FEATURES:append = " wfd-hdcp "
#DISTRO_FEATURES:append = " amlogic-tv "
DISTRO_FEATURES:append = " amlogic-dvb "
#DISTRO_FEATURES:remove = " alsa "
DISTRO_FEATURES:append = " alsa "
DISTRO_FEATURES:append = " pam"
DISTRO_FEATURES_BACKFILL_CONSIDERED = "sysvinit"
DEFAULT_DISTRO_FEATURES += " systemd"
DISTRO_FEATURES:append = " systemd"
DISTRO_FEATURES:remove = " sysvinit"
#DISTRO_FEATURES:append = " opengl"
DISTRO_FEATURES:append = " gstreamer1"
DISTRO_FEATURES:append = " miraclecast "
DISTRO_FEATURES:append = " aml-dtv "
DISTRO_FEATURES:append = " dtvkit "
#DISTRO_FEATURES:append = " AVB "

OVERRIDES .= ":ap222:ap232:s4:onepass"
MACHINEOVERRIDES .= ":client"

DISTRO_FEATURES:append = " bt-qca "
DISTRO_FEATURES:append = " bluetooth bluez5 "
EXTRA_BLUETOOTH_STUFF := "${@bb.utils.contains('DISTRO_FEATURES', 'bluetooth', bb.utils.contains('DISTRO_FEATURES', 'bluez5', ' bluez5', ' bluez4', d), '', d)}"
DISTRO_FEATURES:append = "${EXTRA_BLUETOOTH_STUFF}"

TDK_VERSION:s4 = "v3.8/dev/S905C3"

# For YouTube Cert. Now it's for 2024
DEVICE_PROPERTY_FIRMWARE_VERSION = "1.0.0"
DEVICE_PROPERTY_MODEL_NAME = "OTT-4K-Ref"
DEVICE_PROPERTY_OPERATOR_NAME = "SDKRelease"
DEVICE_PROPERTY_YOUTUBE_CERT_SCOPE = "amlogic-2024-amlogicott4kref2024v2"
DEVICE_PROPERTY_PERSIST_DIALSERVER_NAME="AmlogicOTT-AP232"
# YouTube define device type
# BDP:   Blu-Ray Player
# GAME:  Game Console
# OTT:   Over-The-Top Device
# STB:   Set-Top-Box, which includes a tuner and demodulator
# TV:    Television Set
DEVICE_PROPERTY_DEVICE_TYPE = "OTT"
DEVICE_PROPERTY_CHIPSET = "S905C3"
DEVICE_PROPERTY_MODEL_YEAR = "2024"
# End For YouTube
```

## conf/machine/mesons4d-ap2327.conf
```bitbake
include conf/machine/include/mesons4_k5.4_32b.inc
include conf/machine/mesons4d-ap232.inc

SERIAL_CONSOLES = "115200;ttyS0"

KERNEL_DEVICETREE = "s4d_s905c3_ap2327_linux.dtb"
UBOOT_MACHINE = "s4_ap2327_config"

CHIPSET_NAME = "S905C3NMA"
TDK_VERSION:s4 = "v3.8/dev/S905C3NMA"

DISTRO_FEATURES:remove = " netflix"
```

## conf/machine/mesons4d-aq2431-nand-vmx.conf
```bitbake
include conf/machine/mesons4d-aq2432-common.inc

KERNEL_DEVICETREE = "s4d_s805c3_aq2432_linux_512m_nand.dtb"

DISTRO_FEATURES_append = " verimatrix "
DISTRO_FEATURES_append = " nand "
```

## conf/machine/mesons4d-aq2431-vmx.conf
```bitbake
include conf/machine/mesons4d-aq2432-common.inc

DISTRO_FEATURES:append = " verimatrix "
```
