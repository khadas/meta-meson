## conf/machine/mesonsc2-lib32-ah212-bsp.conf
```bitbake
#@TYPE: Machine
#@NAME: meson

#@DESCRIPTION: Machine configuration for meson systems

include conf/machine/include/mesonsc2_k5.4_64b.inc
include conf/machine/include/amlogic_weston.inc

PREFERRED_PROVIDER_virtual/mesa = "libgles-eabihf-dvalin-wayland-drm"
PREFERRED_PROVIDER_virtual/mesa-gl = "libgles-eabihf-dvalin-wayland-drm"
PREFERRED_PROVIDER_virtual/libgbm = "libgles-eabihf-dvalin-wayland-drm"
PREFERRED_PROVIDER_virtual/egl = "libgles-eabihf-dvalin-wayland-drm"
PREFERRED_PROVIDER_virtual/libgl = "libgles-eabihf-dvalin-wayland-drm"
PREFERRED_PROVIDER_virtual/libgles1 = "libgles-eabihf-dvalin-wayland-drm"
PREFERRED_PROVIDER_virtual/libgles2 = "libgles-eabihf-dvalin-wayland-drm"

MACHINE_EXTRA_RRECOMMENDS += " \
        wififw-qca6174 \
        qca6174 \
        pq-prebuilt \
        tuner-prebuilt \
        aucpu-fw \
        gpu \
        optee-linux-driver \
        tuner-prebuilt \
        "

CHIPSET_NAME = "S905X4"
KERNEL_DEVICETREE = "sc2_s905x4_ah212_linux.dtb"
UBOOT_MACHINE = "sc2_ah212_config"
KERNEL_MODULE_AUTOLOAD += " cxd2856_fe_64"
KERNEL_MODULE_AUTOLOAD += " hdr10_tmo_alg_64"
KERNEL_MODULE_AUTOLOAD += " snd-soc-dummy_codec"
KERNEL_MODULE_AUTOLOAD += " snd-soc-aml_t9015"
KERNEL_MODULE_AUTOLOAD += " snd_soc"
KERNEL_MODULE_AUTOLOAD += " snd_soc_notify"
KERNEL_MODULE_AUTOLOAD += " meson_ir"
KERNEL_MODULE_AUTOLOAD += " btqca"
KERNEL_MODULE_PROBECONF += "btqca"
KERNEL_MODULE_AUTOLOAD += " hci_uart"
KERNEL_MODULE_PROBECONF += "hci_uart"
KERNEL_MODULE_AUTOLOAD += "aml_aucpu"
KERNEL_MODULE_AUTOLOAD += "dolby_fw"
KERNEL_MODULE_AUTOLOAD += "meson-cpufreq"

DISTRO_FEATURES:append = " drm"
DISTRO_FEATURES:append = " secure-u-boot optee "
#DISTRO_FEATURES:append = " absystem"
DISTRO_FEATURES:append = " widevine "
DISTRO_FEATURES:append = " playready "
DISTRO_FEATURES:append = " amlogic-dvb "
DISTRO_FEATURES:append = " alsa "
DISTRO_FEATURES:append = " pam"
DISTRO_FEATURES_BACKFILL_CONSIDERED = "sysvinit"
DEFAULT_DISTRO_FEATURES += " systemd"
DISTRO_FEATURES:append = " systemd"
DISTRO_FEATURES:remove = " sysvinit"
DISTRO_FEATURES:append = " gstreamer1"
DISTRO_FEATURES:append = " aml-dtv "
DISTRO_FEATURES:append = " dtvkit "
DISTRO_FEATURES:append = " recovery "
DISTRO_FEATURES:append = " swupdate "

DISTRO_FEATURES:append = " amlogic-bsp "

DISTRO_FEATURES:remove = " acl xattr selinux"

DISTRO_FEATURES:append = " aml-libjpeg "
DISTRO_FEATURES:append = " aml-libmultienc "
DISTRO_FEATURES:append = " aml-libvpcodec "
DISTRO_FEATURES:append = " aml-libvphevcodec "
DISTRO_FEATURES:append = " gst-plugin-venc "

OVERRIDES .= ":ah212:sc2:onepass"
MACHINEOVERRIDES .= ":client"

DISTRO_FEATURES:append = " bt-qca "
DISTRO_FEATURES:append = " bluetooth bluez5 "
EXTRA_BLUETOOTH_STUFF := "${@bb.utils.contains('DISTRO_FEATURES', 'bluetooth', bb.utils.contains('DISTRO_FEATURES', 'bluez5', ' bluez5', ' bluez4', d), '', d)}"
DISTRO_FEATURES:append = "${EXTRA_BLUETOOTH_STUFF}"
```

## conf/machine/mesonsc2-lib32-ah212-k5.15.conf
```bitbake
include conf/machine/include/mesonsc2_k5.15_64b.inc
include conf/machine/mesonsc2-ah212-common.inc
```

## conf/machine/mesonsc2-lib32-ah212-vmx.conf
```bitbake
include conf/machine/mesonsc2-lib32-ah212.conf

DISTRO_FEATURES:append = " verimatrix "
DISTRO_FEATURES:append = " aml-cas "
```

## conf/machine/mesonsc2-lib32-ah212.conf
```bitbake
include conf/machine/include/mesonsc2_k5.4_64b.inc
include conf/machine/mesonsc2-ah212-common.inc
```

## conf/machine/mesonsc2-lib32-ah221-nagra.conf
```bitbake
include conf/machine/mesonsc2-ah221-common.inc

DISTRO_FEATURES:append = " nagra "
DISTRO_FEATURES:append = " aml-cas "
```

## conf/machine/mesonsc2-lib32-ah232-nagra.conf
```bitbake
include conf/machine/mesonsc2-ah232-common.inc

DISTRO_FEATURES:append = " nagra "
DISTRO_FEATURES:append = " aml-cas "
```

## conf/machine/mesont3-ar301-weston.conf
```bitbake
include conf/machine/mesont3-ar321-weston.conf

KERNEL_DEVICETREE = "t3_t982_ar301-2g_linux.dtb"
UBOOT_MACHINE = "t3_t982_config"
```

## conf/machine/mesont5d-am301-bsp.conf
```bitbake
#@TYPE: Machine
#@NAME: meson

#@DESCRIPTION: Machine configuration for meson systems

include conf/machine/include/mesont5d_k5.4_32b.inc
include conf/machine/include/amlogic_weston.inc

PREFERRED_PROVIDER_virtual/mesa = "libgles-eabihf-dvalin-wayland-drm"
PREFERRED_PROVIDER_virtual/mesa-gl = "libgles-eabihf-dvalin-wayland-drm"
PREFERRED_PROVIDER_virtual/libgbm = "libgles-eabihf-dvalin-wayland-drm"
PREFERRED_PROVIDER_virtual/egl = "libgles-eabihf-dvalin-wayland-drm"
PREFERRED_PROVIDER_virtual/libgl = "libgles-eabihf-dvalin-wayland-drm"
PREFERRED_PROVIDER_virtual/libgles1 = "libgles-eabihf-dvalin-wayland-drm"
PREFERRED_PROVIDER_virtual/libgles2 = "libgles-eabihf-dvalin-wayland-drm"

MACHINE_EXTRA_RRECOMMENDS += " \
        rtk8723bu \
        rtk8723du \
        realtek-btusb \
        realtek-btuart \
        realtek-hciattach \
        pq-prebuilt \
        tuner-prebuilt \
        aucpu-fw \
        gpu \
        optee-linux-driver \
        "

KERNEL_DEVICETREE = "t5d_t950d4_am301_linux_1.5g.dtb t5d_t950d4_am301_linux_1g.dtb"
UBOOT_MACHINE = "t5d_am301_v1"
KERNEL_MODULE_AUTOLOAD += " snd-soc-dummy_codec"
KERNEL_MODULE_AUTOLOAD += " snd-soc-aml_t9015"
KERNEL_MODULE_AUTOLOAD += " snd-soc-aml_codec_tl1_acodec"
KERNEL_MODULE_AUTOLOAD += " snd-soc-tas5805"
KERNEL_MODULE_AUTOLOAD += " meson_ir"
KERNEL_MODULE_AUTOLOAD += " aml_aucpu"
KERNEL_MODULE_AUTOLOAD += " dolby_fw"
KERNEL_MODULE_AUTOLOAD += " meson-cpufreq"
KERNEL_MODULE_AUTOLOAD += " dnlp_alg_32 si2151_fe_32 rt710_fe_32 "
KERNEL_MODULE_AUTOLOAD += " hdr10_tmo_alg_32 "

DISTRO_FEATURES_append = " drm"
DISTRO_FEATURES_append = " secure-u-boot optee "
DISTRO_FEATURES_append = " widevine "
DISTRO_FEATURES_append = " playready "
DISTRO_FEATURES_append = " amlogic-tv "
DISTRO_FEATURES_append = " amlogic-dvb "
DISTRO_FEATURES_append = " alsa "
DISTRO_FEATURES_append = " pam"
DISTRO_FEATURES_BACKFILL_CONSIDERED = "sysvinit"
DEFAULT_DISTRO_FEATURES += " systemd"
DISTRO_FEATURES_append = " systemd"
DISTRO_FEATURES_remove = " sysvinit"
DISTRO_FEATURES_append = " gstreamer1"
DISTRO_FEATURES_append = " aml-dtv "
DISTRO_FEATURES_append = " recovery "
DISTRO_FEATURES_append = " swupdate "
DISTRO_FEATURES_append = " amlogic-bsp "

DISTRO_FEATURES_remove = " acl xattr selinux"

OVERRIDES .= ":am301:t5d:onepass"
MACHINEOVERRIDES .= ":client"

DISTRO_FEATURES_append = " bluetooth bluez5 "
EXTRA_BLUETOOTH_STUFF := "${@bb.utils.contains('DISTRO_FEATURES', 'bluetooth', bb.utils.contains('DISTRO_FEATURES', 'bluez5', ' bluez5', ' bluez4', d), '', d)}"
DISTRO_FEATURES_append = "${EXTRA_BLUETOOTH_STUFF}"
```

## conf/machine/mesont5d-am301-common.inc
```bitbake
include conf/machine/include/amlogic_westeros.inc

PREFERRED_PROVIDER_virtual/mesa = "libgles-eabihf-dvalin-wayland-drm"
PREFERRED_PROVIDER_virtual/mesa-gl = "libgles-eabihf-dvalin-wayland-drm"
PREFERRED_PROVIDER_virtual/libgbm = "libgles-eabihf-dvalin-wayland-drm"
PREFERRED_PROVIDER_virtual/egl = "libgles-eabihf-dvalin-wayland-drm"
PREFERRED_PROVIDER_virtual/libgl = "libgles-eabihf-dvalin-wayland-drm"
PREFERRED_PROVIDER_virtual/libgles1 = "libgles-eabihf-dvalin-wayland-drm"
PREFERRED_PROVIDER_virtual/libgles2 = "libgles-eabihf-dvalin-wayland-drm"

MACHINE_ESSENTIAL_EXTRA_RRECOMMENDS += " \
        rtk8723bu \
        rtk8723du \
        realtek-btusb \
        realtek-btuart \
        realtek-hciattach \
        pq-prebuilt \
        tuner-prebuilt \
        aucpu-fw \
        gpu \
        optee-linux-driver \
        "

KERNEL_DEVICETREE = "t5d_t950d4_am301_linux_1.5g.dtb t5d_reva_t950d4_am301_linux_1.5g.dtb t5d_t950d4_am301_linux_1g.dtb t5d_reva_t950d4_am301_linux_1g.dtb"
UBOOT_MACHINE = "t5d_am301_v1"
KERNEL_MODULE_AUTOLOAD += " snd-soc-dummy_codec"
KERNEL_MODULE_AUTOLOAD += " snd-soc-aml_t9015"
KERNEL_MODULE_AUTOLOAD += " snd-soc-aml_codec_tl1_acodec"
KERNEL_MODULE_AUTOLOAD += " snd-soc-tas5805"
KERNEL_MODULE_AUTOLOAD += " meson_ir"
KERNEL_MODULE_AUTOLOAD += "aml_aucpu"
KERNEL_MODULE_AUTOLOAD += "dolby_fw"
KERNEL_MODULE_AUTOLOAD += "meson-cpufreq"

DISTRO_FEATURES_append = " drm"
#DISTRO_FEATURES_append = " onepass"
DISTRO_FEATURES_append = " secure-u-boot optee "
DISTRO_FEATURES_append = " widevine "
DISTRO_FEATURES_append = " playready "
DISTRO_FEATURES_append = " amlogic-tv "
DISTRO_FEATURES_append = " amlogic-dvb "
DISTRO_FEATURES_append = " dtvkit"
#DISTRO_FEATURES_remove = " alsa "
DISTRO_FEATURES_append = " alsa "
DISTRO_FEATURES_append = " pam"
DISTRO_FEATURES_BACKFILL_CONSIDERED = "sysvinit"
DEFAULT_DISTRO_FEATURES += " systemd"
DISTRO_FEATURES_append = " systemd"
DISTRO_FEATURES_remove = " sysvinit"
#DISTRO_FEATURES_append = " opengl"
DISTRO_FEATURES_append = " gstreamer1"
DISTRO_FEATURES_append = " aml-dtv "
DISTRO_FEATURES_append = " recovery "
DISTRO_FEATURES_append = " swupdate "


OVERRIDES .= ":am301:t5d:onepass"
MACHINEOVERRIDES .= ":client"

DISTRO_FEATURES_append = " bluetooth bluez5 "
EXTRA_BLUETOOTH_STUFF := "${@bb.utils.contains('DISTRO_FEATURES', 'bluetooth', bb.utils.contains('DISTRO_FEATURES', 'bluez5', ' bluez5', ' bluez4', d), '', d)}"
DISTRO_FEATURES_append = "${EXTRA_BLUETOOTH_STUFF}"

# For YouTube Cert. Now it's for 2022
DEVICE_PROPERTY_FIRMWARE_VERSION = "1.0.0"
DEVICE_PROPERTY_MODEL_NAME = "FHD"
DEVICE_PROPERTY_OPERATOR_NAME = "SDKRelease"
DEVICE_PROPERTY_CERT_SCOPE = "amlogic-2022-amlogictvref"
DEVICE_PROPERTY_DIALSERVER_NAME="AmlogicOTT-AM301"
# YouTube define device type
# BDP:   Blu-Ray Player
# GAME:  Game Console
# OTT:   Over-The-Top Device
# STB:   Set-Top-Box, which includes a tuner and demodulator
# TV:    Television Set
DEVICE_PROPERTY_YOUTUBE_DEVICE_TYPE = "TV"
DEVICE_PROPERTY_CHIPSET_MODEL_NUM = "T950D4"
DEVICE_PROPERTY_MODEL_YEAR = "2022"
# End For YouTube

# For amazon
DEVICE_PROPERTY_AMAZON_DTID = "A3SJQCMWSDF1EG"
```

## conf/machine/mesont5d-am301-k5.15.conf
```bitbake
#@TYPE: Machine
#@NAME: meson

#@DESCRIPTION: Machine configuration for meson systems

include conf/machine/include/mesont5d_k5.15_32b.inc

include conf/machine/mesont5d-am301-common.inc

KERNEL_DEVICETREE = "t5d_t950d4_am301_1g_linux.dtb "

KERNEL_MODULE_AUTOLOAD += " dnlp_alg_32 mxl661_fe_32 rt710_fe_32 "
KERNEL_MODULE_AUTOLOAD += " hdr10_tmo_alg_32 "
DISTRO_FEATURES:remove = " gpt-partition"
```

## conf/machine/mesont5d-am301-lowmem.conf
```bitbake
#@TYPE: Machine
#@NAME: meson

#@DESCRIPTION: Machine configuration for meson systems

include conf/machine/include/mesont5d_k5.4_32b.inc

include conf/machine/mesont5d-am301-common.inc

KERNEL_DEVICETREE = "t5d_t950d4_am301_linux_512m.dtb "

KERNEL_MODULE_AUTOLOAD += " dnlp_alg_32 mxl661_fe_32 rt710_fe_32 "
KERNEL_MODULE_AUTOLOAD += " hdr10_tmo_alg_32 "

DISTRO_FEATURES:append = " UI_720P low-memory"
DISTRO_FEATURES:append = " appmanager"

DISTRO_FEATURES:remove = " tts "
DISTRO_FEATURES:remove = " bluetooth bluez5 "
DISTRO_FEATURES:append = " remove-test-files"

ZRAM_FRACTION = "50"

# For YouTube Cert. Now it's for 2023
DEVICE_PROPERTY_PERSIST_YOUTUBE_TOTAL_CPU_MEMORY = "0xAA00000"
DEVICE_PROPERTY_PERSIST_YOUTUBE_GST_APPSRC_VIDEO_SIZE = "0x400000"
DEVICE_PROPERTY_PERSIST_YOUTUBE_GST_APPSRC_AUDIO_SIZE = "0x100000"
DEVICE_PROPERTY_PERSIST_YOUTUBE_VIDEOSINK_LOWMEM = "y"
DEVICE_PROPERTY_PERSIST_YOUTUBE_SECMEM_SIZE_THRESHOLD = "0x20000"
DEVICE_PROPERTY_PERSIST_YOUTUBE_AUDIO_BUFFERING_LOW_LEVEL = "150000000"
DEVICE_PROPERTY_PERSIST_YOUTUBE_AUDIO_BUFFERING_HIGH_LEVEL = "350000000"
DEVICE_PROPERTY_PERSIST_YOUTUBE_VIDEO_BUFFERING_LOW_LEVEL = "150000000"
DEVICE_PROPERTY_PERSIST_YOUTUBE_VIDEO_BUFFERING_HIGH_LEVEL = "350000000"
# End For YouTube
```

## conf/machine/mesont5d-am311-common.inc
```bitbake
include conf/machine/include/amlogic_westeros.inc

PREFERRED_PROVIDER_virtual/mesa = "libgles-eabihf-dvalin-wayland-drm"
PREFERRED_PROVIDER_virtual/mesa-gl = "libgles-eabihf-dvalin-wayland-drm"
PREFERRED_PROVIDER_virtual/libgbm = "libgles-eabihf-dvalin-wayland-drm"
PREFERRED_PROVIDER_virtual/egl = "libgles-eabihf-dvalin-wayland-drm"
PREFERRED_PROVIDER_virtual/libgl = "libgles-eabihf-dvalin-wayland-drm"
PREFERRED_PROVIDER_virtual/libgles1 = "libgles-eabihf-dvalin-wayland-drm"
PREFERRED_PROVIDER_virtual/libgles2 = "libgles-eabihf-dvalin-wayland-drm"

MACHINE_EXTRA_RRECOMMENDS += " \
        rtk8723bu \
        rtk8723du \
        realtek-btusb \
        realtek-btuart \
        realtek-hciattach \
        pq-prebuilt \
        tuner-prebuilt \
        aucpu-fw \
        gpu \
        optee-linux-driver \
        "

CHIPSET_NAME = "T950X4"
KERNEL_DEVICETREE = "t5d_t950x4_am311_linux_1g.dtb t5d_reva_t950x4_am311_linux_1g.dtb t5d_t950x4_am311_linux_512m.dtb t5d_reva_t950x4_am311_linux_512m.dtb"
UBOOT_MACHINE = "t5d_am311_v1"
KERNEL_MODULE_AUTOLOAD += " snd-soc-dummy_codec"
KERNEL_MODULE_AUTOLOAD += " snd-soc-aml_t9015"
KERNEL_MODULE_AUTOLOAD += " snd-soc-aml_codec_tl1_acodec"
KERNEL_MODULE_AUTOLOAD += " snd-soc-tas5805"
KERNEL_MODULE_AUTOLOAD += " meson_ir"
KERNEL_MODULE_AUTOLOAD += "aml_aucpu"
KERNEL_MODULE_AUTOLOAD += "dolby_fw"
KERNEL_MODULE_AUTOLOAD += "meson-cpufreq"

DISTRO_FEATURES:append = " drm"
#DISTRO_FEATURES:append = " onepass"
DISTRO_FEATURES:append = " secure-u-boot optee "
DISTRO_FEATURES:append = " widevine "
DISTRO_FEATURES:append = " playready "
DISTRO_FEATURES:append = " amlogic-tv "
DISTRO_FEATURES:append = " amlogic-dvb "
#DISTRO_FEATURES:remove = " alsa "
DISTRO_FEATURES:append = " alsa "
DISTRO_FEATURES:append = " pam"
DISTRO_FEATURES_BACKFILL_CONSIDERED = "sysvinit"
DEFAULT_DISTRO_FEATURES += " systemd"
DISTRO_FEATURES:append = " systemd"
DISTRO_FEATURES:remove = " sysvinit"
#DISTRO_FEATURES:append = " opengl"
DISTRO_FEATURES:append = " gstreamer1"
DISTRO_FEATURES:append = " aml-dtv "
DISTRO_FEATURES:append = " recovery "
DISTRO_FEATURES:append = " swupdate "


OVERRIDES .= ":am311:t5d:onepass"
MACHINEOVERRIDES .= ":client"

DISTRO_FEATURES:append = " bluetooth bluez5 "
EXTRA_BLUETOOTH_STUFF := "${@bb.utils.contains('DISTRO_FEATURES', 'bluetooth', bb.utils.contains('DISTRO_FEATURES', 'bluez5', ' bluez5', ' bluez4', d), '', d)}"
DISTRO_FEATURES:append = "${EXTRA_BLUETOOTH_STUFF}"

# For YouTube Cert. Now it's for 2023
DEVICE_PROPERTY_FIRMWARE_VERSION = "1.0.0"
DEVICE_PROPERTY_MODEL_NAME = "NA"
DEVICE_PROPERTY_OPERATOR_NAME = "SDKRelease"
DEVICE_PROPERTY_YOUTUBE_CERT_SCOPE = "NA"
DEVICE_PROPERTY_PERSIST_DIALSERVER_NAME="AmlogicOTT-AM311"
# YouTube define device type
# BDP:   Blu-Ray Player
# GAME:  Game Console
# OTT:   Over-The-Top Device
# STB:   Set-Top-Box, which includes a tuner and demodulator
# TV:    Television Set
DEVICE_PROPERTY_DEVICE_TYPE = "TV"
DEVICE_PROPERTY_CHIPSET = "T921D"
DEVICE_PROPERTY_MODEL_YEAR = "2023"
# End For YouTube

# For amazon
DEVICE_PROPERTY_AMAZON_DTID = "A3EYZI5I5ISCN5"

# For nrdp6
DISTRO_FEATURES:append = " tv-fhd-model"
```
