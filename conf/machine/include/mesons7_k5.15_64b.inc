## conf/machine/include/mesons7_k5.15_64b.inc
```bitbake
# common configuration
require conf/machine/include/amlogic_common.inc
require conf/machine/include/amlogic_64b.inc
require conf/machine/include/amlogic_k5.15.inc

PREFERRED_VERSION_u-boot = "v2023.%"
PREFERRED_PROVIDER_virtual/gpu ?= "dvalin"
PREFERRED_PROVIDER_virtual/lib32-gpu ?= "dvalin"
OVERRIDES .= ":s7"
```

## conf/machine/include/mesons7d_k5.15_64b.inc
```bitbake
# common configuration
require conf/machine/include/amlogic_common.inc
require conf/machine/include/amlogic_64b.inc
require conf/machine/include/amlogic_k5.15.inc

PREFERRED_VERSION_u-boot = "v2023.%"
PREFERRED_PROVIDER_virtual/gpu ?= "vale"
PREFERRED_PROVIDER_virtual/lib32-gpu ?= "vale"
OVERRIDES .= ":s7d"
```

## conf/machine/include/mesonsc2_k5.4_64b.inc
```bitbake
# common configuration
require conf/machine/include/amlogic_common.inc
require conf/machine/include/amlogic_64b.inc
require conf/machine/include/amlogic_k5.4.inc

PREFERRED_VERSION_u-boot = "v2019.%"
PREFERRED_PROVIDER_gpu ?= "dvalin"
OVERRIDES .= ":sc2"
```

## conf/machine/include/mesonsm1_k6.6_64b.inc
```bitbake
# common configuration
require conf/machine/include/amlogic_common.inc
require conf/machine/include/amlogic_64b.inc
require conf/machine/include/amlogic_k6.6.inc

PREFERRED_VERSION_u-boot = "v2015.%"
#We can't select revsion in external source mode, but use MACHINE define to control it.
PREFERRED_PROVIDER_virtual/gpu ?= "dvalin"
#OVERRIDES .= ":ac200:sm1:onepass"
```

## conf/machine/include/mesont3_k5.15_64b.inc
```bitbake
# common configuration
require conf/machine/include/amlogic_common.inc
require conf/machine/include/amlogic_64b.inc
require conf/machine/include/amlogic_k5.15.inc

PREFERRED_VERSION_u-boot = "v2019.%"
PREFERRED_PROVIDER_virtual/gpu ?= "gondul"
PREFERRED_PROVIDER_virtual/lib32-gpu ?= "gondul"
OVERRIDES .= ":t3"
```

## conf/machine/include/mesont5w_k5.15_32b.inc
```bitbake
# common configuration
require conf/machine/include/amlogic_common.inc
require conf/machine/include/amlogic_32b.inc
require conf/machine/include/amlogic_k5.15.inc

PREFERRED_PROVIDER_virtual/gpu ?= "dvalin"
PREFERRED_VERSION_u-boot = "v2015.%"
OVERRIDES .= ":t5w:kernel32"
```

## conf/machine/include/mesontm2.inc
```bitbake
# common configuration
require conf/machine/include/amlogic_common.inc
require conf/machine/include/amlogic_32b.inc

#PREFERRED_PROVIDER_virtual/gpu ?= "dvalin"
OVERRIDES .= ":tm2"
```

## conf/machine/include/mesontm2_5.4.inc
```bitbake
# common configuration
require conf/machine/include/amlogic_common.inc
require conf/machine/include/amlogic_64b.inc

PREFERRED_VERSION_u-boot = "v2015.%"
PREFERRED_VERSION_linux-meson = "5.4%"
#PREFERRED_PROVIDER_virtual/gpu ?= "dvalin"
OVERRIDES .= ":tm2-5.4"
```

## conf/machine/include/mesontm2_k5.4_64b.inc
```bitbake
# common configuration
require conf/machine/include/amlogic_common.inc
require conf/machine/include/amlogic_64b.inc
require conf/machine/include/amlogic_k5.4.inc

PREFERRED_VERSION_u-boot = "v2015.%"
PREFERRED_PROVIDER_gpu ?= "dvalin"
OVERRIDES .= ":tm2"
```

## conf/machine/mesonp1-pxp.conf
```bitbake
#@TYPE: Machine
#@NAME: meson

#@DESCRIPTION: Machine configuration for meson systems

include conf/machine/include/mesonp1_k5.4_64b.inc

KERNEL_DEVICETREE = "p1_pxp.dtb"
UBOOT_MACHINE = "p1_pxp"
LINUX_VERSION = "5.4.86"

MACHINE_EXTRA_RRECOMMENDS += " \
        optee-linux-driver \
        "

DISTRO_FEATURES_append = " alsa "
DISTRO_FEATURES_BACKFILL_CONSIDERED = "sysvinit"
DEFAULT_DISTRO_FEATURES += " systemd"
DISTRO_FEATURES_append = " systemd"
DISTRO_FEATURES_remove = " sysvinit"
DISTRO_FEATURES_remove = " opengl"
DISTRO_FEATURES_append = " gstreamer1"

DISTRO_FEATURES_remove = " mesa mesa-gl x11"
DISTRO_FEATURES_remove = " cairo"
DISTRO_FEATURES_remove = " wayland"
DISTRO_FEATURES_NATIVESDK_remove = "x11"

RDEPENDS_packagegroup-amlogic-baserootfs_remove = "aml-libdvr aml-mp-sdk aml-cas-hal aml-pqserver aml-hdcp aml-hdcp-load-firmware aml-hdmicec"
RDEPENDS_packagegroup-amlogic-baserootfs_remove = "gst-plugin-aml-asink gst-aml-drm-plugins gstreamer1.0-libav gst-player"
#Remove thunder framework related
RDEPENDS_packagegroup-amlogic-baserootfs_remove = "bluetooth-mgr bluetooth-core"

MACHINE_ESSENTIAL_EXTRA_RRECOMMENDS_remove = "media-modules"


OVERRIDES .= ":pxp:p1:onepass"
MACHINEOVERRIDES .= ":client"

EXTRA_BLUETOOTH_STUFF := "${@bb.utils.contains('DISTRO_FEATURES', 'bluetooth', bb.utils.contains('DISTRO_FEATURES', 'bluez5', ' bluez5', ' bluez4', d), '', d)}"
DISTRO_FEATURES_append = "${EXTRA_BLUETOOTH_STUFF}"
```

## conf/machine/mesons1a-bg201-irdeto-imw.conf
```bitbake
#@TYPE: Machine
#@NAME: meson

#@DESCRIPTION: Machine configuration for meson systems

include conf/machine/mesons1a-bg201.conf

DISTRO_FEATURES:append = " irdeto irdeto-imw"
```

## conf/machine/mesons1a-bg201.conf
```bitbake
#@TYPE: Machine
#@NAME: meson

#@DESCRIPTION: Machine configuration for meson systems

include conf/machine/include/mesons1a_k5.15_32b.inc
include conf/machine/include/amlogic_nogpu.inc

MACHINE_ESSENTIAL_EXTRA_RRECOMMENDS += " \
        aucpu-fw \
        tuner-prebuilt \
        "

CHIPSET_NAME = "S805C1"
KERNEL_DEVICETREE = "s1a_s805c1_bg201_256m.dtb"
UBOOT_MACHINE = "s1a_bg201"

DISTRO_FEATURES:append = " nand"
#DISTRO_FEATURES:append = " irdeto"
DISTRO_FEATURES:append = " irdeto-ree-only"
ROOTFS_TYPE = "squashfs"

KERNEL_MODULE_AUTOLOAD += " amlogic-socinfo"
KERNEL_MODULE_AUTOLOAD += " amlogic-snd-soc"
KERNEL_MODULE_AUTOLOAD += " amlogic-snd-codec-t9015"
KERNEL_MODULE_AUTOLOAD += " rt710_fe_32 "
KERNEL_MODULE_PROBECONF += "rt710_fe_32"
module_conf_rt710_fe_32 = "options rt710_fe_32  RT710_OUTPUT_MODE=N"

DISTRO_FEATURES:append = " secure-u-boot optee tee-no-videofirmware "
DISTRO_FEATURES:append = " alsa "
DISTRO_FEATURES:append = " aml-dtv "
DISTRO_FEATURES:append = " amlogic-dvb "
DISTRO_FEATURES:append = " recovery "
DISTRO_FEATURES:append = " zapper-2k "
DISTRO_FEATURES:append = " aml-SUB-FB "
DISTRO_FEATURES:append = " dfb "
DISTRO_FEATURES:append = " swupdate "
DISTRO_FEATURES:append = " swupdate-dvb-ota "
DISTRO_FEATURES:append = " dtb-bind-kernel "
DISTRO_FEATURES:append = " arka arka-project-sun arka-launcher arka-hdi"
DISTRO_FEATURES:append = " aml-iptv "
DISTRO_FEATURES:append = " disable-audio-server disable-msync disable-amadec"
DISTRO_FEATURES:append = " disable-binderfs"

DISTRO_FEATURES:remove = " vendor-partition"
DISTRO_FEATURES:remove = " bluetooth wifi ipv6 ipvsec nfc nfs 3g smbfs ppp zeroconf "
DISTRO_FEATURES:remove = " acl xattr pam selinux"
DISTRO_FEATURES:remove = " gpt-partition"
DISTRO_FEATURES:remove = " system-user"
MACHINE_FEATURES:remove = " phone pci pcmcia "
POKY_DEFAULT_DISTRO_FEATURES:remove = " wayland "

TDK_VERSION:s1a = "v3.8/dev/S805C1"
OVERRIDES .= ":bg201"
MACHINEOVERRIDES .= ":client"

# Use sysvinit for system initialization
DISTRO_FEATURES:append = " sysvinit"
DISTRO_FEATURES_BACKFILL_CONSIDERED:append = " systemd"
VIRTUAL-RUNTIME_init_manager = "sysvinit"
VIRTUAL-RUNTIME_initscripts = "initscripts"
VIRTUAL-RUNTIME_login_manager = "busybox"

# remove networking init scripts and configuration files
SYSVINIT_SCRIPTS:remove = " init-ifupdown"
```

## conf/machine/mesons1a-bg209.conf
```bitbake
#@TYPE: Machine
#@NAME: meson

#@DESCRIPTION: Machine configuration for meson systems

include conf/machine/mesons1a-bg201.conf

KERNEL_DEVICETREE = "s1a_s805c1_bg209_256m.dtb"
UBOOT_MACHINE = "s1a_bg209"

KERNEL_MODULE_AUTOLOAD += " cxd2856_fe_32 r836_fe_32 av2018_fe_32"
```

## conf/machine/mesons4-ap222-32b.inc
```bitbake
#@TYPE: Machine
#@NAME: meson

#@DESCRIPTION: Machine configuration for meson systems

include conf/machine/include/mesons4_k5.4_32b.inc

include conf/machine/mesons4-ap222-common.inc

KERNEL_MODULE_AUTOLOAD:remove = " cxd2856_fe_64 r836_fe_64 av2018_fe_64 "
KERNEL_MODULE_AUTOLOAD:remove = " hdr10_tmo_alg_64"
KERNEL_MODULE_AUTOLOAD += " cxd2856_fe_32 r836_fe_32 av2018_fe_32 "
KERNEL_MODULE_AUTOLOAD += " hdr10_tmo_alg_32"
```

## conf/machine/mesons4-ap222-bsp.conf
```bitbake
#@TYPE: Machine
#@NAME: meson

#@DESCRIPTION: Machine configuration for meson systems

include conf/machine/include/mesons4_k5.4_32b.inc
include conf/machine/include/amlogic_weston.inc

PREFERRED_PROVIDER_virtual/mesa = "libgles-eabihf-dvalin-wayland-drm"
PREFERRED_PROVIDER_virtual/mesa-gl = "libgles-eabihf-dvalin-wayland-drm"
PREFERRED_PROVIDER_virtual/libgbm = "libgles-eabihf-dvalin-wayland-drm"
PREFERRED_PROVIDER_virtual/egl = "libgles-eabihf-dvalin-wayland-drm"
PREFERRED_PROVIDER_virtual/libgl = "libgles-eabihf-dvalin-wayland-drm"
PREFERRED_PROVIDER_virtual/libgles1 = "libgles-eabihf-dvalin-wayland-drm"
PREFERRED_PROVIDER_virtual/libgles2 = "libgles-eabihf-dvalin-wayland-drm"

MACHINE_EXTRA_RRECOMMENDS += " \
        wififw-qca6174 \
        qca6174 \
        pq-prebuilt \
        tuner-prebuilt \
        aucpu-fw \
        gpu \
        optee-linux-driver \
        tuner-prebuilt \
        "

CHIPSET_NAME = "S905Y4"
KERNEL_DEVICETREE = "s4_s905y4_ap222_linux.dtb "
UBOOT_MACHINE = "s4_ap222_config"

KERNEL_MODULE_AUTOLOAD += " cxd2856_fe_32 r836_fe_32 av2018_fe_32 "
KERNEL_MODULE_AUTOLOAD += " hdr10_tmo_alg_64"
KERNEL_MODULE_AUTOLOAD += " snd-soc-dummy_codec"
KERNEL_MODULE_AUTOLOAD += " snd-soc-aml_t9015"
KERNEL_MODULE_AUTOLOAD += " snd_soc"
KERNEL_MODULE_AUTOLOAD += " snd_soc_notify"
KERNEL_MODULE_AUTOLOAD += " meson_ir"
KERNEL_MODULE_AUTOLOAD += " btqca"
KERNEL_MODULE_PROBECONF += "btqca"
KERNEL_MODULE_AUTOLOAD += " hci_uart"
KERNEL_MODULE_PROBECONF += "hci_uart"
KERNEL_MODULE_AUTOLOAD += " aml_aucpu"
KERNEL_MODULE_AUTOLOAD += " dolby_fw"
KERNEL_MODULE_AUTOLOAD += " meson-cpufreq"

DISTRO_FEATURES_append = " drm"
DISTRO_FEATURES_append = " secure-u-boot optee "
DISTRO_FEATURES_append = " widevine "
DISTRO_FEATURES_append = " playready "
DISTRO_FEATURES_append = " amlogic-dvb "
DISTRO_FEATURES_append = " alsa "
DISTRO_FEATURES_append = " pam"
DISTRO_FEATURES_BACKFILL_CONSIDERED = "sysvinit"
DEFAULT_DISTRO_FEATURES += " systemd"
DISTRO_FEATURES_append = " systemd"
DISTRO_FEATURES_remove = " sysvinit"
DISTRO_FEATURES_append = " gstreamer1"
DISTRO_FEATURES_append = " aml-dtv "
DISTRO_FEATURES_append = " dtvkit "
DISTRO_FEATURES_append = " recovery "
DISTRO_FEATURES_append = " swupdate "
DISTRO_FEATURES_append = " amlogic-bsp "

DISTRO_FEATURES_remove = " acl xattr selinux"

OVERRIDES .= ":ap222:s4:onepass"
MACHINEOVERRIDES .= ":client"

DISTRO_FEATURES_append = " bt-qca "
DISTRO_FEATURES_append = " bluetooth bluez5 "
EXTRA_BLUETOOTH_STUFF := "${@bb.utils.contains('DISTRO_FEATURES', 'bluetooth', bb.utils.contains('DISTRO_FEATURES', 'bluez5', ' bluez5', ' bluez4', d), '', d)}"
DISTRO_FEATURES_append = "${EXTRA_BLUETOOTH_STUFF}"
```

## conf/machine/mesons4-ap222-common.inc
```bitbake
include conf/machine/include/amlogic_westeros.inc

PREFERRED_PROVIDER_virtual/mesa = "libgles-eabihf-dvalin-wayland-drm"
PREFERRED_PROVIDER_virtual/mesa-gl = "libgles-eabihf-dvalin-wayland-drm"
PREFERRED_PROVIDER_virtual/libgbm = "libgles-eabihf-dvalin-wayland-drm"
PREFERRED_PROVIDER_virtual/egl = "libgles-eabihf-dvalin-wayland-drm"
PREFERRED_PROVIDER_virtual/libgl = "libgles-eabihf-dvalin-wayland-drm"
PREFERRED_PROVIDER_virtual/libgles1 = "libgles-eabihf-dvalin-wayland-drm"
PREFERRED_PROVIDER_virtual/libgles2 = "libgles-eabihf-dvalin-wayland-drm"

MACHINE_EXTRA_RRECOMMENDS += " \
        wififw-qca6174 \
        qca6174 \
        tuner-prebuilt \
        aucpu-fw \
        gpu \
        optee-linux-driver \
        "

KERNEL_DEVICETREE = "s4_s905y4_ap222_linux.dtb s4d_s905y4_ap222_linux.dtb"
UBOOT_MACHINE = "s4_ap222_config"
KERNEL_MODULE_AUTOLOAD += " cxd2856_fe_64 r836_fe_64 av2018_fe_64 "
KERNEL_MODULE_AUTOLOAD += " snd-soc-dummy_codec"
KERNEL_MODULE_AUTOLOAD += " snd-soc-aml_t9015"
KERNEL_MODULE_AUTOLOAD += " snd_soc"
KERNEL_MODULE_AUTOLOAD += " snd_soc_notify"
KERNEL_MODULE_AUTOLOAD += " meson_ir"
KERNEL_MODULE_AUTOLOAD += " btqca"
KERNEL_MODULE_PROBECONF += "btqca"
KERNEL_MODULE_AUTOLOAD += " hci_uart"
KERNEL_MODULE_PROBECONF += "hci_uart"
KERNEL_MODULE_AUTOLOAD += "aml_aucpu"
KERNEL_MODULE_AUTOLOAD += "dolby_fw"
KERNEL_MODULE_AUTOLOAD += "meson-cpufreq"
KERNEL_MODULE_AUTOLOAD += " media_sync"

DISTRO_FEATURES_append = " drm"
#DISTRO_FEATURES_append = " onepass"
DISTRO_FEATURES_append = " secure-u-boot optee "
DISTRO_FEATURES_append = " widevine "
DISTRO_FEATURES_append = " playready "
DISTRO_FEATURES_append = " wfd-hdcp "
DISTRO_FEATURES_append = " aml-iptv "
#DISTRO_FEATURES_append = " amlogic-tv "
DISTRO_FEATURES_append = " amlogic-dvb "
#DISTRO_FEATURES_remove = " alsa "
DISTRO_FEATURES_append = " alsa "
DISTRO_FEATURES_append = " pam"
DISTRO_FEATURES_BACKFILL_CONSIDERED = "sysvinit"
DEFAULT_DISTRO_FEATURES += " systemd"
DISTRO_FEATURES_append = " systemd"
DISTRO_FEATURES_remove = " sysvinit"
#DISTRO_FEATURES_append = " opengl"
DISTRO_FEATURES_append = " gstreamer1"
DISTRO_FEATURES_append = " aml-dtv "
DISTRO_FEATURES_append = " aml-cas "
#DISTRO_FEATURES_append = " AVB "
DISTRO_FEATURES_append = " recovery "
DISTRO_FEATURES_append = " swupdate "

# enable selinux
DISTRO_FEATURES_append = " acl xattr pam selinux"
# set the policy
PREFERRED_PROVIDER_virtual/refpolicy ?= "refpolicy-standard"
DEFAULT_ENFORCING = "permissive"

OVERRIDES .= ":ap222:s4:onepass"
MACHINEOVERRIDES .= ":client"

DISTRO_FEATURES_append = " bluetooth bluez5 "
EXTRA_BLUETOOTH_STUFF := "${@bb.utils.contains('DISTRO_FEATURES', 'bluetooth', bb.utils.contains('DISTRO_FEATURES', 'bluez5', ' bluez5', ' bluez4', d), '', d)}"
DISTRO_FEATURES_append = "${EXTRA_BLUETOOTH_STUFF}"

# dm-verity
#DISTRO_FEATURES_append = " dm-verity"
#DISTRO_FEATURES_NATIVE_append = " dm-verity"

# For YouTube Cert. Now it's for 2022
DEVICE_PROPERTY_FIRMWARE_VERSION = "1.0.0"
DEVICE_PROPERTY_MODEL_NAME = "OTT-4K-Ref"
DEVICE_PROPERTY_OPERATOR_NAME = "SDKRelease"
DEVICE_PROPERTY_CERT_SCOPE = "amlogic-2022-amlogicottref4k2022"
DEVICE_PROPERTY_DIALSERVER_NAME="AmlogicOTT-AP222"
# YouTube define device type
# BDP:   Blu-Ray Player
# GAME:  Game Console
# OTT:   Over-The-Top Device
# STB:   Set-Top-Box, which includes a tuner and demodulator
# TV:    Television Set
DEVICE_PROPERTY_YOUTUBE_DEVICE_TYPE = "OTT"
DEVICE_PROPERTY_CHIPSET_MODEL_NUM = "S905Y4"
DEVICE_PROPERTY_MODEL_YEAR = "2022"
# End For YouTube

# For amazon
DEVICE_PROPERTY_AMAZON_DTID = "A3SJQCMWSDF1EG"
```

## conf/machine/mesons4-ap222-nand-zapper.conf
```bitbake
#@TYPE: Machine
#@NAME: meson

#@DESCRIPTION: Machine configuration for meson systems

include conf/machine/include/mesons4_k5.4_32b.inc
include conf/machine/include/amlogic_nogpu.inc


MACHINE_ESSENTIAL_EXTRA_RRECOMMENDS += " \
        aucpu-fw \
        optee-linux-driver \
        tuner-prebuilt \
        "

CHIPSET_NAME = "S905Y4"
KERNEL_DEVICETREE = "s4_s905y4_ap222_linux.dtb s4d_s905y4_ap222_linux.dtb"
UBOOT_MACHINE = "s4_ap222_config"

DISTRO_FEATURES_append = " nand"
ROOTFS_TYPE = "squashfs"

KERNEL_MODULE_AUTOLOAD += " snd-soc-dummy_codec"
KERNEL_MODULE_AUTOLOAD += " snd-soc-aml_t9015"
KERNEL_MODULE_AUTOLOAD += " meson_ir"
KERNEL_MODULE_AUTOLOAD += " aml_aucpu"
KERNEL_MODULE_AUTOLOAD += " meson-cpufreq"
KERNEL_MODULE_AUTOLOAD += " media_sync"
KERNEL_MODULE_AUTOLOAD += " cxd2856_fe_32 r836_fe_32 av2018_fe_32 "

DISTRO_FEATURES_append = " secure-u-boot optee "
DISTRO_FEATURES_append = " alsa "
DISTRO_FEATURES_BACKFILL_CONSIDERED = "sysvinit"
DEFAULT_DISTRO_FEATURES += " systemd"
DISTRO_FEATURES_append = " systemd"
DISTRO_FEATURES_append = " aml-dtv "
DISTRO_FEATURES_append = " amlogic-dvb "
DISTRO_FEATURES_append = " recovery "
DISTRO_FEATURES_append = " zapper "
DISTRO_FEATURES_append = " dfb "
DISTRO_FEATURES_append = " swupdate "

DISTRO_FEATURES_remove = " sysvinit"
DISTRO_FEATURES_remove = " bluetooth wifi ipv6 ipvsec nfc nfs 3g smbfs ppp zeroconf "
DISTRO_FEATURES_remove = " acl xattr pam selinux"

MACHINE_FEATURES_remove = " phone pci pcmcia "

OVERRIDES .= ":ap222:s4:onepass"
MACHINEOVERRIDES .= ":client"
```
