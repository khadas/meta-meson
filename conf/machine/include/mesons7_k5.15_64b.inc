## conf/machine/mesons4-ap222-vmx.conf
```bitbake
include conf/machine/mesons4-ap222-32b.inc

DISTRO_FEATURES:append = " verimatrix "
DISTRO_FEATURES:append = " aml-cas "
DISTRO_FEATURES:append = " AVB "

DEVICE_PROPERTY_BOOT_PARTITION_SIZE = "0x4000000"
DEVICE_PROPERTY_VBMETA_ROLLBACK_INDEX = "0"
```

## conf/machine/mesons4-ap222-zapper.conf
```bitbake
#@TYPE: Machine
#@NAME: meson

#@DESCRIPTION: Machine configuration for meson systems

include conf/machine/include/mesons4_k5.4_32b.inc
include conf/machine/include/amlogic_nogpu.inc

MACHINE_ESSENTIAL_EXTRA_RRECOMMENDS += " \
        aucpu-fw \
        tuner-prebuilt \
        "

CHIPSET_NAME = "S905Y4"
KERNEL_DEVICETREE = "s4_s905y4_ap222_linux.dtb s4d_s905y4_ap222_linux.dtb"
UBOOT_MACHINE = "s4_ap222_config"
KERNEL_MODULE_AUTOLOAD += " snd-soc-dummy_codec"
KERNEL_MODULE_AUTOLOAD += " snd-soc-aml_t9015"
KERNEL_MODULE_AUTOLOAD += " meson_ir"
KERNEL_MODULE_AUTOLOAD += " aml_aucpu"
KERNEL_MODULE_AUTOLOAD += " meson-cpufreq"
KERNEL_MODULE_AUTOLOAD += " media_sync"
KERNEL_MODULE_AUTOLOAD += " cxd2856_fe_32 r836_fe_32 av2018_fe_32 "

DISTRO_FEATURES:append = " secure-u-boot optee "
DISTRO_FEATURES:append = " alsa "
DISTRO_FEATURES_BACKFILL_CONSIDERED = "sysvinit"
DEFAULT_DISTRO_FEATURES += " systemd"
DISTRO_FEATURES:append = " systemd"
DISTRO_FEATURES:append = " aml-dtv "
DISTRO_FEATURES:append = " amlogic-dvb "
DISTRO_FEATURES:append = " recovery "
DISTRO_FEATURES:append = " aml-SUB-FB "
DISTRO_FEATURES:append = " dfb "
DISTRO_FEATURES:append = " swupdate "
DISTRO_FEATURES:append = " aml-iptv "
DISTRO_FEATURES:append = " swupdate-dvb-ota "
DISTRO_FEATURES:append = " dolby-ms12 "

DISTRO_FEATURES:remove = " sysvinit"
DISTRO_FEATURES:remove = " bluetooth wifi ipv6 ipvsec nfc nfs 3g smbfs ppp zeroconf "
DISTRO_FEATURES:remove = " acl xattr pam selinux"

MACHINE_FEATURES:remove = " phone pci pcmcia "

OVERRIDES .= ":ap222:s4:onepass"
MACHINEOVERRIDES .= ":client"

SYSTEM_DM_VERITY_IMAGE = "${@bb.utils.contains('MULTILIBS', 'multilib:lib32', 'lib32-amlogic-zapper', 'amlogic-zapper', d)}"
```

## conf/machine/mesons4-aq222-westeros.inc
```bitbake
include conf/machine/include/amlogic_westeros.inc

PREFERRED_PROVIDER_virtual/mesa = "libgles-eabihf-dvalin-wayland-drm"
PREFERRED_PROVIDER_virtual/mesa-gl = "libgles-eabihf-dvalin-wayland-drm"
PREFERRED_PROVIDER_virtual/libgbm = "libgles-eabihf-dvalin-wayland-drm"
PREFERRED_PROVIDER_virtual/egl = "libgles-eabihf-dvalin-wayland-drm"
PREFERRED_PROVIDER_virtual/libgl = "libgles-eabihf-dvalin-wayland-drm"
PREFERRED_PROVIDER_virtual/libgles1 = "libgles-eabihf-dvalin-wayland-drm"
PREFERRED_PROVIDER_virtual/libgles2 = "libgles-eabihf-dvalin-wayland-drm"

MACHINE_EXTRA_RRECOMMENDS += " \
        wififw-qca6174 \
        qca6174 \
        pq-prebuilt \
        tuner-prebuilt \
        aucpu-fw \
        gpu \
        optee-linux-driver \
        "

CHIPSET_NAME = "S805X2"
KERNEL_DEVICETREE = "s4_s805x2_aq222_linux_1g.dtb"
UBOOT_MACHINE = "s4_aq222_config"
KERNEL_MODULE_AUTOLOAD += " cxd2856_fe_64 r836_fe_64 av2018_fe_64 "
KERNEL_MODULE_AUTOLOAD += " hdr10_tmo_alg_64"
KERNEL_MODULE_AUTOLOAD += " snd-soc-dummy_codec"
KERNEL_MODULE_AUTOLOAD += " snd-soc-aml_t9015"
KERNEL_MODULE_AUTOLOAD += " snd_soc"
KERNEL_MODULE_AUTOLOAD += " snd_soc_notify"
KERNEL_MODULE_AUTOLOAD += " meson_ir"
KERNEL_MODULE_AUTOLOAD += " btqca"
KERNEL_MODULE_PROBECONF += "btqca"
KERNEL_MODULE_AUTOLOAD += " hci_uart"
KERNEL_MODULE_PROBECONF += "hci_uart"
KERNEL_MODULE_AUTOLOAD += "aml_aucpu"
KERNEL_MODULE_AUTOLOAD += "dolby_fw"
KERNEL_MODULE_AUTOLOAD += "meson-cpufreq"

DISTRO_FEATURES:append = " drm"
#DISTRO_FEATURES:append = " onepass"
DISTRO_FEATURES:append = " secure-u-boot optee "
DISTRO_FEATURES:append = " widevine "
DISTRO_FEATURES:append = " playready "
DISTRO_FEATURES:append = " wfd-hdcp "
#DISTRO_FEATURES:append = " amlogic-tv "
DISTRO_FEATURES:append = " amlogic-dvb "
DISTRO_FEATURES:append = " dtvkit "
#DISTRO_FEATURES:remove = " alsa "
DISTRO_FEATURES:append = " alsa "
DISTRO_FEATURES:append = " pam"
DISTRO_FEATURES_BACKFILL_CONSIDERED = "sysvinit"
DEFAULT_DISTRO_FEATURES += " systemd"
DISTRO_FEATURES:append = " systemd"
DISTRO_FEATURES:remove = " sysvinit"
#DISTRO_FEATURES:append = " opengl"
DISTRO_FEATURES:append = " gstreamer1"
DISTRO_FEATURES:append = " aml-dtv "
#DISTRO_FEATURES:append = " AVB "
DISTRO_FEATURES:append = " recovery "
DISTRO_FEATURES:append = " swupdate "

OVERRIDES .= ":aq222:s4:onepass"
MACHINEOVERRIDES .= ":client"

DISTRO_FEATURES:append = " bt-qca "
DISTRO_FEATURES:append = " bluetooth bluez5 "
EXTRA_BLUETOOTH_STUFF := "${@bb.utils.contains('DISTRO_FEATURES', 'bluetooth', bb.utils.contains('DISTRO_FEATURES', 'bluez5', ' bluez5', ' bluez4', d), '', d)}"
DISTRO_FEATURES:append = "${EXTRA_BLUETOOTH_STUFF}"

TDK_VERSION:s4 = "v3.8/dev/S805X2"

# For YouTube Cert. Now it's for 2023
DEVICE_PROPERTY_FIRMWARE_VERSION = "1.0.0"
DEVICE_PROPERTY_MODEL_NAME = "NA"
DEVICE_PROPERTY_OPERATOR_NAME = "SDKRelease"
DEVICE_PROPERTY_YOUTUBE_CERT_SCOPE = "NA"
DEVICE_PROPERTY_PERSIST_DIALSERVER_NAME="AmlogicOTT-AP222"
# YouTube define device type
# BDP:   Blu-Ray Player
# GAME:  Game Console
# OTT:   Over-The-Top Device
# STB:   Set-Top-Box, which includes a tuner and demodulator
# TV:    Television Set
DEVICE_PROPERTY_DEVICE_TYPE = "OTT"
DEVICE_PROPERTY_CHIPSET = "S905Y4"
DEVICE_PROPERTY_MODEL_YEAR = "2023"
DEVICE_PROPERTY_PERSIST_YOUTUBE_FORCE_4K = "n"
# End For YouTube

# For amazon
DEVICE_PROPERTY_AMAZON_DTID = "A3SJQCMWSDF1EG"
```

## conf/machine/mesons4-aq223-nand.conf
```bitbake
#@TYPE: Machine
#@NAME: meson

#@DESCRIPTION: Machine configuration for meson systems

include conf/machine/include/mesons4_k5.4_32b.inc
#include conf/machine/include/mesons4_k5.4_64b.inc

include conf/machine/mesons4-westeros.inc

CHIPSET_NAME = "S805X2"
KERNEL_DEVICETREE = "s4_s805x2_aq222_linux_nand_512m.dtb"
UBOOT_MACHINE = "s4_aq222_config"

OVERRIDES .= ":aq222"
TDK_VERSION:s4 = "v3.8/dev/S805X2"

MACHINE_EXTRA_RRECOMMENDS:remove = " wififw-qca6174 qca6174"
KERNEL_MODULE_AUTOLOAD:remove = " btqca "
KERNEL_MODULE_PROBECONF:remove = " btqca "

MACHINE_EXTRA_RRECOMMENDS:append = " aml-wifi-w1 aml-bt-w1"
DISTRO_FEATURES:remove = " bt-qca "
DISTRO_FEATURES:append = " aml-w1 "

DISTRO_FEATURES:append = " UI_720P low-memory "
DISTRO_FEATURES:append = " appmanager "
DISTRO_FEATURES:append = " zapperplus "
DISTRO_FEATURES:append = " nand "
DISTRO_FEATURES:append = " webkitbrowser "
ROOTFS_TYPE = "squashfs"
DM_VERITY_IMAGE_TYPE = "squashfs"

DISTRO_FEATURES:remove = " tts "
DISTRO_FEATURES:remove = " bluetooth bluez5 "
DISTRO_FEATURES:append = " remove-test-files"

ZRAM_FRACTION = "50"

# For YouTube Cert. Now it's for 2023
DEVICE_PROPERTY_PERSIST_YOUTUBE_TOTAL_CPU_MEMORY = "0xAA00000"
DEVICE_PROPERTY_PERSIST_YOUTUBE_GST_APPSRC_VIDEO_SIZE = "0x400000"
DEVICE_PROPERTY_PERSIST_YOUTUBE_GST_APPSRC_AUDIO_SIZE = "0x100000"
DEVICE_PROPERTY_PERSIST_YOUTUBE_VIDEOSINK_LOWMEM = "y"
DEVICE_PROPERTY_PERSIST_YOUTUBE_SECMEM_SIZE_THRESHOLD = "0x20000"
DEVICE_PROPERTY_PERSIST_YOUTUBE_AUDIO_BUFFERING_LOW_LEVEL = "150000000"
DEVICE_PROPERTY_PERSIST_YOUTUBE_AUDIO_BUFFERING_HIGH_LEVEL = "350000000"
DEVICE_PROPERTY_PERSIST_YOUTUBE_VIDEO_BUFFERING_LOW_LEVEL = "150000000"
DEVICE_PROPERTY_PERSIST_YOUTUBE_VIDEO_BUFFERING_HIGH_LEVEL = "350000000"
# End For YouTube
```
