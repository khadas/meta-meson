## conf/machine/mesont5w-at301-bsp.conf
```bitbake
#@TYPE: Machine
#@NAME: meson

#@DESCRIPTION: Machine configuration for meson systems

include conf/machine/include/mesont5w_k5.4_32b.inc
include conf/machine/include/amlogic_weston.inc
include conf/machine/include/amlogic_bsp.inc

PREFERRED_PROVIDER_virtual/mesa = "libgles-eabihf-dvalin-wayland-drm"
PREFERRED_PROVIDER_virtual/mesa-gl = "libgles-eabihf-dvalin-wayland-drm"
PREFERRED_PROVIDER_virtual/libgbm = "libgles-eabihf-dvalin-wayland-drm"
PREFERRED_PROVIDER_virtual/egl = "libgles-eabihf-dvalin-wayland-drm"
PREFERRED_PROVIDER_virtual/libgl = "libgles-eabihf-dvalin-wayland-drm"
PREFERRED_PROVIDER_virtual/libgles1 = "libgles-eabihf-dvalin-wayland-drm"
PREFERRED_PROVIDER_virtual/libgles2 = "libgles-eabihf-dvalin-wayland-drm"

MACHINE_EXTRA_RRECOMMENDS += " \
        rtk8822cu \
        realtek-btusb \
        realtek-btuart \
        realtek-hciattach \
        "

KERNEL_DEVICETREE = "t5w_t962d4_at301_linux.dtb t5w_t962d4_at301_linux_1g.dtb t5w_t962d4_at301_linux_1.5g.dtb"
UBOOT_MACHINE = "t5w_at301_v1"
KERNEL_MODULE_AUTOLOAD += " snd-soc-dummy_codec"
KERNEL_MODULE_AUTOLOAD += " snd-soc-aml_t9015"
KERNEL_MODULE_AUTOLOAD += " snd-soc-aml_codec_tl1_acodec"
KERNEL_MODULE_AUTOLOAD += " snd-soc-tas5805"
KERNEL_MODULE_AUTOLOAD += " meson_ir"
KERNEL_MODULE_AUTOLOAD += " aml_aucpu"
KERNEL_MODULE_AUTOLOAD += " dolby_fw"
KERNEL_MODULE_AUTOLOAD += " meson-cpufreq"
KERNEL_MODULE_AUTOLOAD += " dnlp_alg_32 si2151_fe_32 rt710_fe_32 "
KERNEL_MODULE_AUTOLOAD += " hdr10_tmo_alg_32 "

DISTRO_FEATURES:append = " drm"
DISTRO_FEATURES:append = " secure-u-boot optee "
DISTRO_FEATURES:append = " widevine "
DISTRO_FEATURES:append = " playready "
DISTRO_FEATURES:append = " amlogic-tv "
DISTRO_FEATURES:append = " amlogic-dvb "
DISTRO_FEATURES:append = " alsa "
DISTRO_FEATURES:append = " pam"
DISTRO_FEATURES_BACKFILL_CONSIDERED = "sysvinit"
DEFAULT_DISTRO_FEATURES += " systemd"
DISTRO_FEATURES:append = " systemd"
DISTRO_FEATURES:remove = " sysvinit"
DISTRO_FEATURES:append = " gstreamer1"
DISTRO_FEATURES:append = " aml-dtv "
DISTRO_FEATURES:append = " recovery "
DISTRO_FEATURES:append = " swupdate "
DISTRO_FEATURES:append = " amlogic-bsp "

DISTRO_FEATURES:remove = " acl xattr selinux"

OVERRIDES .= ":at301:t5w:onepass"
MACHINEOVERRIDES .= ":client"

DISTRO_FEATURES:append = " bluetooth bluez5 "
EXTRA_BLUETOOTH_STUFF := "${@bb.utils.contains('DISTRO_FEATURES', 'bluetooth', bb.utils.contains('DISTRO_FEATURES', 'bluez5', ' bluez5', ' bluez4', d), '', d)}"
DISTRO_FEATURES:append = "${EXTRA_BLUETOOTH_STUFF}"
```

## conf/machine/mesont5w-at301-common.inc
```bitbake
include conf/machine/include/amlogic_westeros.inc

PREFERRED_PROVIDER_virtual/mesa = "libgles-eabihf-dvalin-wayland-drm"
PREFERRED_PROVIDER_virtual/mesa-gl = "libgles-eabihf-dvalin-wayland-drm"
PREFERRED_PROVIDER_virtual/libgbm = "libgles-eabihf-dvalin-wayland-drm"
PREFERRED_PROVIDER_virtual/egl = "libgles-eabihf-dvalin-wayland-drm"
PREFERRED_PROVIDER_virtual/libgl = "libgles-eabihf-dvalin-wayland-drm"
PREFERRED_PROVIDER_virtual/libgles1 = "libgles-eabihf-dvalin-wayland-drm"
PREFERRED_PROVIDER_virtual/libgles2 = "libgles-eabihf-dvalin-wayland-drm"

MACHINE_EXTRA_RRECOMMENDS += " \
        rtk8822cu \
        realtek-btusb \
        realtek-btuart \
        realtek-hciattach \
        pq-prebuilt \
        tuner-prebuilt \
        aucpu-fw \
        gpu \
        "

CHIPSET_NAME = "T962D4"
KERNEL_DEVICETREE = "t5w_t962d4_at301_linux.dtb t5w_t962d4_at301_linux_1g.dtb t5w_t962d4_at301_linux_1.5g.dtb"
UBOOT_MACHINE = "t5w_at301_v1"
KERNEL_MODULE_AUTOLOAD += " snd-soc-dummy_codec"
KERNEL_MODULE_AUTOLOAD += " 88x2cu"
KERNEL_MODULE_AUTOLOAD += " rtk_btuart"
KERNEL_MODULE_AUTOLOAD += " rtk_btusb"
KERNEL_MODULE_AUTOLOAD += " snd-soc-aml_t9015"
KERNEL_MODULE_AUTOLOAD += " snd-soc-aml_codec_tl1_acodec"
KERNEL_MODULE_AUTOLOAD += " snd-soc-tas5805"
KERNEL_MODULE_AUTOLOAD += " meson_ir"
KERNEL_MODULE_AUTOLOAD += "aml_aucpu"
KERNEL_MODULE_AUTOLOAD += "dolby_fw"
KERNEL_MODULE_AUTOLOAD += "meson-cpufreq"

DISTRO_FEATURES:append = " drm"
#DISTRO_FEATURES:append = " onepass"
DISTRO_FEATURES:append = " secure-u-boot optee "
#DISTRO_FEATURES:append = " absystem"
DISTRO_FEATURES:append = " widevine "
DISTRO_FEATURES:append = " playready "
DISTRO_FEATURES:append = " amlogic-tv "
DISTRO_FEATURES:append = " amlogic-dvb "
DISTRO_FEATURES:append = " dtvkit"
#DISTRO_FEATURES:remove = " alsa "
DISTRO_FEATURES:append = " alsa "
DISTRO_FEATURES:append = " pam"
DISTRO_FEATURES_BACKFILL_CONSIDERED = "sysvinit"
DEFAULT_DISTRO_FEATURES += " systemd"
DISTRO_FEATURES:append = " systemd"
DISTRO_FEATURES:remove = " sysvinit"
#DISTRO_FEATURES:append = " opengl"
DISTRO_FEATURES:append = " gstreamer1"
DISTRO_FEATURES:append = " aml-dtv "
DISTRO_FEATURES:append = " AVB AVB_recovery_partition "
DEVICE_PROPERTY_BOOT_PARTITION_SIZE = "0x4000000"
DEVICE_PROPERTY_VBMETA_ROLLBACK_INDEX = "0"
DEVICE_PROPERTY_RECOVERY_PARTITION_SIZE = "0x2000000"
DEVICE_PROPERTY_RECOVERY_ROLLBACK_INDEX = "0"
DEVICE_PROPERTY_RECOVERY_ROLLBACK_LOCATION = "31"


OVERRIDES .= ":at301:t5w:onepass"
MACHINEOVERRIDES .= ":client"

DISTRO_FEATURES:append = " bluetooth bluez5 "
EXTRA_BLUETOOTH_STUFF := "${@bb.utils.contains('DISTRO_FEATURES', 'bluetooth', bb.utils.contains('DISTRO_FEATURES', 'bluez5', ' bluez5', ' bluez4', d), '', d)}"
DISTRO_FEATURES:append = "${EXTRA_BLUETOOTH_STUFF}"

# For YouTube Cert. Now it's for 2024
DEVICE_PROPERTY_FIRMWARE_VERSION = "1.0.0"
DEVICE_PROPERTY_MODEL_NAME = "TV-4K-Ref"
DEVICE_PROPERTY_OPERATOR_NAME = "SDKRelease"
DEVICE_PROPERTY_YOUTUBE_CERT_SCOPE = "amlogic-2024-amlogictv4kref2024v2"
DEVICE_PROPERTY_PERSIST_DIALSERVER_NAME="AmlogicTV-AT301"
# YouTube define device type
# BDP:   Blu-Ray Player
# GAME:  Game Console
# OTT:   Over-The-Top Device
# STB:   Set-Top-Box, which includes a tuner and demodulator
# TV:    Television Set
DEVICE_PROPERTY_DEVICE_TYPE = "TV"
DEVICE_PROPERTY_CHIPSET = "T962D4"
DEVICE_PROPERTY_MODEL_YEAR = "2024"
DEVICE_PROPERTY_TV_PANEL_SIZE = "43"
# End For YouTube
```

## conf/machine/mesont5w-at301-k5.15.conf
```bitbake
#@TYPE: Machine
#@NAME: meson

#@DESCRIPTION: Machine configuration for meson systems

include conf/machine/include/mesont5w_k5.15_32b.inc

include conf/machine/mesont5w-at301-common.inc

KERNEL_DEVICETREE = "t5w_t962d4_at301_linux.dtb "

KERNEL_MODULE_AUTOLOAD += " dnlp_alg_32 si2151_fe_32 rt710_fe_32 "
KERNEL_MODULE_AUTOLOAD += " hdr10_tmo_alg_32 "
DISTRO_FEATURES:remove = " gpt-partition"
```

## conf/machine/mesontm2_ab311.conf
```bitbake
#@TYPE: Machine
#@NAME: meson

#@DESCRIPTION: Machine configuration for meson systems

include conf/machine/include/mesontm2.inc

PREFERRED_PROVIDER_virtual/mesa = "libgles-eabihf-dvalin-wayland-drm"
PREFERRED_PROVIDER_virtual/mesa-gl = "libgles-eabihf-dvalin-wayland-drm"
PREFERRED_PROVIDER_virtual/libgbm = "libgles-eabihf-dvalin-wayland-drm"
PREFERRED_PROVIDER_virtual/egl = "libgles-eabihf-dvalin-wayland-drm"
PREFERRED_PROVIDER_virtual/libgl = "libgles-eabihf-dvalin-wayland-drm"
PREFERRED_PROVIDER_virtual/libgles1 = "libgles-eabihf-dvalin-wayland-drm"
PREFERRED_PROVIDER_virtual/libgles2 = "libgles-eabihf-dvalin-wayland-drm"

MACHINE_ESSENTIAL_EXTRA_RRECOMMENDS += " \
        gpu \
        optee-linux-driver "
#        wififw-ap6398 \
#        ap6xxx \
#        pq-prebuilt \
#        "

KERNEL_DEVICETREE = "tm2_t962e2_ab311_drm_buildroot.dtb tm2_revb_t962e2_ab311_drm_buildroot.dtb"
UBOOT_MACHINE = "tm2_t962e2_ab311_v1_config"
#KERNEL_MODULE_AUTOLOAD += " dhd"
#KERNEL_MODULE_PROBECONF += "dhd"
#module_conf_dhd = "options dhd firmware_path=/etc/wifi/6398/ nvram_path=/etc/wifi/6398/nvram.txt"
DISTRO_FEATURES_append = " drm"
#DISTRO_FEATURES_append = " onepass"
DISTRO_FEATURES_append = " secure-u-boot optee "
#DISTRO_FEATURES_append = " opencdm "
DISTRO_FEATURES_append = " widevine "
#DISTRO_FEATURES_append = " amlogic-tv "
#DISTRO_FEATURES_append = " amlogic-dvb "
#DISTRO_FEATURES_remove = " alsa "
DISTRO_FEATURES_append = " alsa "
DISTRO_FEATURES_append = " widevine_hardware"
DISTRO_FEATURES_append = " pam"
VIRTUAL-RUNTIME_init_manager = "systemd"
DISTRO_FEATURES_BACKFILL_CONSIDERED = "sysvinit"
VIRTUAL-RUNTIME_initscripts = ""
DEFAULT_DISTRO_FEATURES += " systemd"
DISTRO_FEATURES_append = " systemd"
DISTRO_FEATURES_remove = " sysvinit"
#DISTRO_FEATURES_append = " opengl"
DISTRO_FEATURES_append = " gstreamer1"

#For Weston
DISTRO_FEATURES_append = " weston wayland weston-init"
DISTRO_FEATURES_remove = " mesa mesa-gl x11"
#DISTRO_FEATURES_NATIVESDK_remove = "x11"

PREFERRED_VERSION_weston = "8.0.0"
PREFERRED_VERSION_wayland = "1.17.0"
PREFERRED_VERSION_wayland-protocol = "1.18.0"

#PREFERRED_VERSION_mesa="19.1.1"
#PREFERRED_VERSION_mesa-gl="19.1.1"

OVERRIDES .= ":wonka:tm2:onepass"
MACHINEOVERRIDES .= ":client"
PREFERRED_PROVIDER_widevine = "aml-mediadrm-widevine"

EXTRA_BLUETOOTH_STUFF := "${@bb.utils.contains('DISTRO_FEATURES', 'bluetooth', bb.utils.contains('DISTRO_FEATURES', 'bluez5', ' bluez5', ' bluez4', d), '', d)}"
DISTRO_FEATURES_append = "${EXTRA_BLUETOOTH_STUFF}"

VIRTUAL-RUNTIME_init_manager ?= "systemd"
VIRTUAL-RUNTIME_initscripts ?= "systemd-compat-units"

VOLATILE_BINDS = "/var/volatile/www /www\n"
VOLATILE_BINDS_append = "/var/volatile/resolv.conf /etc/resolv.conf\n"
VOLATILE_BINDS_append = "/var/volatile/asound.conf /etc/asound.conf\n"
VOLATILE_BINDS_append = "/var/volatile/resolv.dnsmasq /etc/resolv.dnsmasq\n"
VOLATILE_BINDS_append = "/var/volatile/hosts /etc/hosts\n"
VOLATILE_BINDS_append = "/var/volatile/hostname /etc/hostname\n"
VOLATILE_BINDS_append = "/var/volatile/dhcp_static_hosts /etc/dhcp_static_hosts\n"
VOLATILE_BINDS_append = "/var/volatile/cron /var/spool/cron\n"
VOLATILE_BINDS_append_hybrid = "/tmp/snmpd.conf /etc/snmp/snmpd.conf\n"
VOLATILE_BINDS_append_client = "/tmp/timesyncd.conf /etc/systemd/timesyncd.conf\n"
VOLATILE_BINDS_append_hybrid = "/tmp/udhcpc.vendor_specific /etc/udhcpc.vendor_specific\n"
VOLATILE_BINDS_append = "/tmp/dibbler /etc/dibbler\n"
VOLATILE_BINDS_append = "/var/volatile/xupnp /etc/xupnp\n"
VOLATILE_BINDS_append = "/tmp/samhain /var/samhain\n"
XZ_COMPRESSION_LEVEL ?= "-e -M 50% -9"
#PREFERRED_PROVIDER_libgudev = "${@base_conditional('PREFERRED_VERSION_systemd', '1:216%', 'systemd', 'libgudev', d)}"
```

## recipes-core/images/files/boot-template.its
```
/*
 * U-boot uImage source file with multiple kernels, ramdisks and FDT blobs
 */

/dts-v1/;

/ {
  description = "Various kernels, ramdisks and FDT blobs";
  #address-cells = <1>;

  images {
    kernel@1 {
      description = "kernel-4.9";
      data = /incbin/("KERNEL_IMG_PATH");
      type = "kernel";
      arch = "KERNEL_IMG_ARCH";
      os = "linux";
      compression = "none";
      load = <KERNEL_LOADADDR>;
      entry = <KERNEL_LOADADDR>;
      hash@1 {
        algo = "sha1";
      };
    };

    ramdisk@1 {
      description = "ramdisk";
      data = /incbin/("RAMDISK_IMG_PATH");
      type = "ramdisk";
      arch = "RAMDISK_IMG_ARCH";
      os = "linux";
      compression = "none";
      load = <0x20000000>;
      entry = <0x20000000>;
      hash@1 {
        algo = "sha1";
      };
    };

    fdt@1 {
      description = "FDT_DESC";
      data = /incbin/("FDT_IMG_PATH");
      type = "flat_dt";
      arch = "FDT_IMG_ARCH";
      compression = "none";
      hash@1 {
        algo = "sha1";
      };
    };
  };

  configurations {
    default = "config@1";

    config@1 {
      description = "boot configuration";
      kernel = "kernel@1";
      ramdisk = "ramdisk@1";
      fdt = "fdt@1";
    };
  };
};
```
