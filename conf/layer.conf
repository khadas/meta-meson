## conf/machine/include/mesons4_k5.4_32b.inc
```bitbake
# common configuration
require conf/machine/include/amlogic_common.inc
require conf/machine/include/amlogic_32b.inc
require conf/machine/include/amlogic_k5.4.inc

PREFERRED_VERSION_u-boot = "v2019.%"
#We can't select revsion in external source mode, but use MACHINE define to control it.
PREFERRED_PROVIDER_gpu ?= "dvalin"
OVERRIDES .= ":s4:kernel32"
```

## conf/machine/include/mesons4_k5.4_64b.inc
```bitbake
# common configuration
require conf/machine/include/amlogic_common.inc
require conf/machine/include/amlogic_64b.inc
require conf/machine/include/amlogic_k5.4.inc

PREFERRED_VERSION_u-boot = "v2019.%"
#We can't select revsion in external source mode, but use MACHINE define to control it.
PREFERRED_PROVIDER_virtual/gpu ?= "dvalin"
OVERRIDES .= ":s4"
```

## conf/machine/include/mesons5_k5.15_64b.inc
```bitbake
# common configuration
require conf/machine/include/amlogic_common.inc
require conf/machine/include/amlogic_64b.inc
require conf/machine/include/amlogic_k5.15.inc

PREFERRED_VERSION_u-boot = "v2019.%"
PREFERRED_PROVIDER_gpu ?= "valhall"
OVERRIDES .= ":s5"
```
