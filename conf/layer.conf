## conf/layer.conf
```bitbake
# We have a conf and classes directory, add to BBPATH
BBPATH .= ":${LAYERDIR}"

# We have a recipes-* directories, add to BBFILES
BBFILES += "${LAYERDIR}/recipes-*/*/*.bb \
	${LAYERDIR}/recipes-*/*/*.bbappend"

BBFILE_COLLECTIONS += "meson"
BBFILE_PATTERN_meson = "^${LAYERDIR}/"
BBFILE_PRIORITY_meson = "6"
LICENSE_PATH += "${LAYERDIR}/license"
#SPDXLICENSEMAP[AMLOGIC] = "LICENSE.AML"
LAYERSERIES_COMPAT_meson = "dunfell kirkstone"
#INCOMPATIBLE_LICENSE = "GPL-3.0-only GPL-3.0-or-later LGPLv3.0 LGPL-3.0-only LGPL-3.0-or-later "
```

## conf/machine/include/amlogic_32b.inc
```bitbake
DEFAULTTUNE = "armv7athf-neon"

#PREFERRED_PROVIDER_virtual/closedcaption-hal = "closedcaption-hal-amlogic"
PREFERRED_PROVIDER_virtual/gst-plugins-playersinkbin = "gst-plugins-playersinkbin-rpi"
#PREFERRED_PROVIDER_virtual/iarmmgrs-hal = "iarmmgrs-hal-amlogic"
#PREFERRED_PROVIDER_virtual/mfrlib = "mfrlib-amlogic"
#DISTRO_FEATURES:remove += "opengl gl"
DISTRO_FEATURES:remove += "parodus 3g zeroconf"
VIRTUAL-RUNTIME_alsa-state ?= "alsa-states"

# append drm(wayland drm backend)
DISTRO_FEATURES:append = " drm gles2"
#DISTRO_FEATURES:append = " wpeframework"
DISTRO_FEATURES:append = " clearkey"
#DISTRO_FEATURES:remove = " rdkbrowser2"
#WPELauncher is not used any more.WPEFramework now as a launcher
#DISTRO_FEATURES:append = " wpelauncher"
DISTRO_FEATURES:append = " wifi"
DISTRO_FEATURES:append = " systemd-disable-getty"
DISTRO_FEATURES:append = " dunfell"
MACHINEOVERRIDES .= ":wpe:thunder"
DISTROOVERRIDES .= ":dunfell"
#PREFERRED_VERSION_libopus = "1.1"

include conf/include/bbmasks-amlogic-platform.inc
PREFERRED_VERSION_cmake-native= "3.16.5"
PREFERRED_VERSION_youtube= "23%"
```

## conf/machine/include/amlogic_64b.inc
```bitbake
#DEFAULTTUNE = "armv7athf-neon"

#PREFERRED_PROVIDER_virtual/closedcaption-hal = "closedcaption-hal-amlogic"
PREFERRED_PROVIDER_virtual/gst-plugins-playersinkbin = "gst-plugins-playersinkbin-rpi"
#PREFERRED_PROVIDER_virtual/iarmmgrs-hal = "iarmmgrs-hal-amlogic"
#PREFERRED_PROVIDER_virtual/mfrlib = "mfrlib-amlogic"
#DISTRO_FEATURES_remove += "opengl gl"
DISTRO_FEATURES_remove += "parodus 3g zeroconf"
VIRTUAL-RUNTIME_alsa-state ?= "alsa-states"

# append drm(wayland drm backend)
DISTRO_FEATURES_append = " drm gles2"
#DISTRO_FEATURES_append = " wpeframework"
DISTRO_FEATURES_append = " clearkey"
#DISTRO_FEATURES_remove = " rdkbrowser2"
#WPELauncher is not used any more.WPEFramework now as a launcher
#DISTRO_FEATURES_append = " wpelauncher"
DISTRO_FEATURES_append = " wifi"
DISTRO_FEATURES_append = " systemd-disable-getty"
DISTRO_FEATURES_append = " dunfell"
DISTROOVERRIDES .= ":dunfell"
#PREFERRED_VERSION_libopus = "1.1"

include conf/include/bbmasks-amlogic-platform.inc
PREFERRED_VERSION_cmake-native= "3.16.5"
```

## conf/machine/include/amlogic_bsp.inc
```bitbake
#For bsp common
MACHINE_EXTRA_RRECOMMENDS += " \
        pq-prebuilt \
        tuner-prebuilt \
        aucpu-fw \
        gpu \
        coreutils \
        "
```

## conf/machine/include/amlogic_common.inc
```bitbake
require conf/machine/include/arm/arch-armv8a.inc
include conf/machine/include/amlogic_externalsrc.inc
include conf/machine/include/amlogic_patches.inc
include conf/machine/include/device-properties.inc

MACHINE_ESSENTIAL_EXTRA_RRECOMMENDS += " \
        media-modules "

RRECOMMENDS:${KERNEL_PACKAGE_NAME}-base = ""
MACHINE_EXTRA_RRECOMMENDS = " kernel-modules kernel-devicetree"
EXTRA_IMAGEDEPENDS += "u-boot"
IMAGE_FSTYPES += "tar.gz ext4"
ROOTFS_TYPE = "ext4"

IMAGE_GEN_DEBUGFS = "1"
IMAGE_FSTYPES_DEBUGFS = ""
SERIAL_CONSOLES = "921600;ttyS0"
SERIAL_CONSOLES:t5w = "115200;ttyS0"
SERIAL_CONSOLES:t3 = "115200;ttyS0"
SERIAL_CONSOLES:g12b = "115200;ttyS0"
SERIAL_CONSOLES:sm1 = "115200;ttyS0"

PREFERRED_PROVIDER_virtual/kernel ?= "linux-meson"
KERNEL_IMAGETYPE:aarch64 = "Image.gz"
KERNEL_IMAGETYPE:armv7a = "uImage"
UBOOT_SUFFIX = "bin"
MACHINE_FEATURES = "usbgadget usbhost vfat "
IMAGE_BOOT_FILES ?= "u-boot.${UBOOT_SUFFIX}"
INITRAMFS_FSTYPES = "cpio.gz"

#KERNEL_MODULE_AUTOLOAD += "mali"
TDK_VERSION = "v3.8"
TDK_VERSION:t5d = "v2.4"
TDK_VERSION:sc2 = "v3.8/dev/S905X4"
TDK_VERSION:t7 = "v3.8/dev/A311D2"
TDK_VERSION:s4 = "v3.8/dev/S905Y4"
TDK_VERSION:s7 = "v3.8/dev/S905Y5"
TDK_VERSION:t3 = "v3.8/dev/T965D4"
TDK_VERSION:t5w = "v3.8/dev/T962D4"

PLATFORM_TDK_VERSION = "v3.8.0"
PLATFORM_TDK_VERSION:s7 = "v3.18.0"

#Widevine Version
WIDEVINE_VERSION = "16"

#Playready Version
PLAYREADY_VERSION = "4.4"

AML_GIT_ROOT ?= "git.myamlogic.com"
AML_GIT_PROTOCOL ?= "git"
AML_GIT_ROOT_YOCTO_SUFFIX ?= "/yocto"
AML_GIT_ROOT_PR ?= "git.myamlogic.com"
AML_GIT_ROOT_WV ?= "git.myamlogic.com"
AML_GIT_ROOT_PROTOCOL ?= "git"

#check connectivity using bing
#CONNECTIVITY_CHECK_URIS = "https://www.bing.com/"

PREFERRED_VERSION_libdrm = "2.4.100"
PREFERRED_VERSION_libdrm-native = "2.4.110"
PREFERRED_VERSION_tinyalsa = "1.1.1"

#Only support amlogic widevine
PREFERRED_PROVIDER_widevine = "aml-mediadrm-widevine"

PREFERRED_VERSION_libgles-eabihf-dvalin-wayland-drm = "r44p0"
PREFERRED_VERSION_libgles-eabihf-gondul-wayland-drm = "r44p0"

#for vulkan
PREFERRED_VERSION_vulkan-headers = "1.2.196"
PREFERRED_VERSION_vulkan-loader = "1.2.196"

#for cairo
PREFERRED_VERSION_cairo_dunfell = "1.14.6"

WARN_QA:append = "ldflags installed-vs-shipped already-stripped pkgvarcheck file-rdeps"
ERROR_QA:remove = "ldflags installed-vs-shipped already-stripped pkgvarcheck file-rdeps"

DEBUG_PREFIX_MAP = "-fdebug-prefix-map=${WORKDIR}=/usr/src/debug/${PN}/${EXTENDPE}${PV}-${PR} \
                    -fdebug-prefix-map=${STAGING_DIR_HOST}= \
                    -fdebug-prefix-map=${STAGING_DIR_NATIVE}= \
                    "

HOSTTOOLS_NONFATAL += "bc cc c++ bison repo python crc32"

DISABLE_STATIC:pn-libevent = ""

AML_RDK_PREBUILT_SITE ?= "http://10.18.11.6/shanghai/image/linux-distro/Public/YOCTO/prebuilt/"
AML_TOOLS_SITE ?= "http://10.18.11.120:8000/Tools"
# define sign tool
#AML_SCS_SIGN_TOOL = "${COREBASE}/../aml-comp/prebuilt/hosttools/aml-linux-scs/Aml_Linux_SCS_SignTool/amlogic_scs_sign_whole_pkg.bash"
# define config files device-keys and fw_arb.cfg
#AML_SCS_SIGN_CONFIG_PATH = "${COREBASE}/../aml-comp/prebuilt/hosttools/aml-linux-scs"
# define sign v3 tool
#AML_SB_SIGN_TOOL = "${COREBASE}/../aml-comp/prebuilt/hosttools/aml-linux-sb/Aml_Linux_SecureBootV3_SignTool/amlogic_secureboot_sign_whole_pkg.bash"
# define config files keys
#AML_SB_SIGN_CONFIG_PATH = "${COREBASE}/../aml-comp/prebuilt/hosttools/aml-linux-sb"

# For dm-verity
# System partition ( This should be overwrited by platform conf if the target is not amlogic-yocto )
SYSTEM_DM_VERITY_IMAGE ??= "${@bb.utils.contains('DISTRO_FEATURES', 'dm-verity', \
                             bb.utils.contains('MULTILIBS', 'multilib:lib32', 'lib32-amlogic-yocto', 'amlogic-yocto', d), '', d)}"
SYSTEM_DM_VERITY_IMAGE_TYPE ??= "${@bb.utils.contains('DISTRO_FEATURES', 'dm-verity', '${ROOTFS_TYPE}', '', d)}"
# vendor partition
VENDOR_DM_VERITY_IMAGE ??= "${@bb.utils.contains('DISTRO_FEATURES', 'dm-verity', \
                             bb.utils.contains('DISTRO_FEATURES', 'vendor-partition', 'vendor-image', '' ,d), '', d)}"
VENDOR_DM_VERITY_IMAGE_TYPE ??= "${@bb.utils.contains('DISTRO_FEATURES', 'dm-verity', '${ROOTFS_TYPE}', '', d)}"

XZ_COMPRESSION_LEVEL ?= "-e -M 50% -9"

VIRTUAL-RUNTIME_init_manager ?= "systemd"
VIRTUAL-RUNTIME_initscripts ?= "systemd-compat-units"

KERNEL_MODULE_AUTOLOAD += "gpio_keypad adc_keypad reg_access"
KERNEL_MODULE_AUTOLOAD += " ${@bb.utils.contains('DISTRO_FEATURES', 'aml-dtv', 'afd_module', '', d)}"

# set bootup splash
SPLASH ?= "psplash"

# default has recovery and swupdate
DISTRO_FEATURES:append = " recovery"
DISTRO_FEATURES:append = " swupdate swupdate-enc"

# default has vendor partition
DISTRO_FEATURES:append = " vendor-partition"

#wpeframework system uer mode
DISTRO_FEATURES:append = " system-user"

# enable selinux
DISTRO_FEATURES:append = " acl xattr pam selinux"
# set the policy
PREFERRED_PROVIDER_virtual/refpolicy ?= "refpolicy-standard"
DEFAULT_ENFORCING = "permissive"

#Production Mode
#Disable overlay readonly rootfs
#Use dm-verity to verify rootfs
#Disable tty console
#Disable adb
#Disable thunder UI
#Disable ssh, telnet and related ports
#RELEASE_MODE = " PROD"

#Overlay Filesystem
DISTRO_FEATURES:append = " ${@bb.utils.contains('RELEASE_MODE', 'PROD', '', 'OverlayFS', d)}"

# dm-verity
DISTRO_FEATURES:append = " ${@bb.utils.contains('RELEASE_MODE', 'PROD', 'dm-verity', '', d)}"

DISTRO_FEATURES:append = " adb dropbear"
DISTRO_FEATURES:append = " cec voiceinput "
DISTRO_FEATURES:append = " screencapture "

# SWUpdate UI config graphic library
SWUPDATE_UI_LIB = "lvgl"
```

## conf/machine/include/amlogic_k5.15.inc
```bitbake
PREFERRED_VERSION_linux-meson = "5.15%"
PREFERRED_VERSION_media-modules = "5.15%"
PREFERRED_VERSION_qca6174 = "5.15%"
LINUXLIBCVERSION = "5.15%"
OVERRIDES .= ":k5.15"
DISTRO_FEATURES:append = " kernel_515"
```

## conf/machine/include/amlogic_k5.4.inc
```bitbake
PREFERRED_VERSION_linux-meson = "5.4%"
PREFERRED_VERSION_media-modules = "5.4%"
PREFERRED_VERSION_qca6174 = "5.4%"
LINUXLIBCVERSION = "5.4%"
OVERRIDES .= ":k5.4"
```

## conf/machine/include/amlogic_k6.6.inc
```bitbake
PREFERRED_VERSION_linux-meson = "6.6%"
PREFERRED_VERSION_media-modules = "6.6%"
PREFERRED_VERSION_qca6174 = "6.6%"
LINUXLIBCVERSION = "6.6%"
OVERRIDES .= ":k6.6"
DISTRO_FEATURES:append = " kernel_66"
DISTRO_FEATURES:append = " gpt-partition"
```

## conf/machine/include/amlogic_nogpu.inc
```bitbake
#For No GPU
DISTRO_FEATURES:remove = " mesa mesa-gl x11"
DISTRO_FEATURES:append = " no-gpu"

#Remove thunder framework related
RDEPENDS:packagegroup-amlogic-baserootfs:remove = " "
```

## conf/machine/include/amlogic_raw.inc
```bitbake
#For Raw System
DISTRO_FEATURES:remove = " mesa mesa-gl x11"
DISTRO_FEATURES:remove = " amazon youtube netflix"
```

## conf/machine/include/amlogic_scs.inc
```bitbake
DISTRO_FEATURES:append = " AVB"
DISTRO_FEATURES:append = " AVB READONLY dm-verity"
DISTRO_FEATURES:append = " scs"

DEVICE_PROPERTY_BOOT_PARTITION_SIZE="0x4000000"
DEVICE_PROPERTY_VBMETA_ROLLBACK_INDEX="0"
DEVICE_PROPERTY_RECOVERY_PARTITION_SIZE="0x2800000"
DEVICE_PROPERTY_RECOVERY_ROLLBACK_LOCATION="31"
DEVICE_PROPERTY_RECOVERY_ROLLBACK_INDEX="0"

DM_VERITY_IMAGE_TYPE = "ext4"
```

## conf/machine/include/amlogic_westeros.inc
```bitbake
#For WesterOS
DISTRO_FEATURES:remove = " mesa mesa-gl x11"
#DISTRO_FEATURES:append = " opencdm"
DISTRO_FEATURES:append = " westeros enable_icrypto_openssl rdkshell safec one-rdk no-rdk-deps aml-thunder"
DISTRO_FEATURES:append = " tts"
DISTRO_FEATURES:append = " aml-launcher"
DISTRO_FEATURES:append = " aml-thunder"
DISTRO_FEATURES:append = " youtube"
DISTRO_FEATURES:append = " amazon"
DISTRO_FEATURES:append = " mediaplayer"
DISTRO_FEATURES:append = " netflix"
DISTRO_FEATURES:append = " disney"
DISTRO_FEATURES:append = " arka use-egl arka-project-aml"

PREFERRED_VERSION_amazon-prime-video = "5.0"
PREFERRED_VERSION_netflix = "dpi7.0"
PREFERRED_VERSION_wpa-supplicant = "2.10"
```

## conf/machine/include/amlogic_weston.inc
```bitbake
#For Weston
DISTRO_FEATURES:append = " weston wayland weston-init"
PREFERRED_VERSION_weston = "10.0.0"
PREFERRED_VERSION_wayland = "1.19.0"
PREFERRED_VERSION_wayland-protocol = "1.24.0"
DISTRO_FEATURES:remove = " mesa mesa-gl x11"

DISTRO_FEATURES:remove = " amazon youtube netflix"

#Remove thunder framework related
RDEPENDS:packagegroup-amlogic-baserootfs:remove = "bluetooth-mgr bluetooth-core"
```

## conf/machine/include/device-properties.inc
```bitbake
# For YouTube
DEVICE_PROPERTY_FIRMWARE_VERSION ?= "Unknown"
DEVICE_PROPERTY_BRAND_NAME ?= "Amlogic"
DEVICE_PROPERTY_MODEL_NAME ?= "Unknown"
DEVICE_PROPERTY_OPERATOR_NAME ?= "Unknown"
DEVICE_PROPERTY_YOUTUBE_CERT_SCOPE ?= "Unknown"
# YouTube define device type
# BDP:   Blu-Ray Player
# GAME:  Game Console
# OTT:   Over-The-Top Device
# STB:   Set-Top-Box, which includes a tuner and demodulator
# TV:    Television Set
DEVICE_PROPERTY_DEVICE_TYPE ?= "Unknown"
DEVICE_PROPERTY_CHIPSET ?= "Unknown"
DEVICE_PROPERTY_MODEL_YEAR ?= "Unknown"
DEVICE_PROPERTY_PLATFORM_NAME ?= "Linux"
DEVICE_PROPERTY_SYSINTEGRATE_NAME ?= "Amlogic"
# End For YouTube

# For Amazon
DEVICE_PROPERTY_AMAZON_DTID ?= "${@bb.utils.contains('DISTRO_FEATURES', 'amazon', bb.utils.contains('DISTRO_FEATURES', 'amlogic-tv', 'AEKBK0TQX6QYF', 'A3SJQCMWSDF1EG', d), '', d)}"
# End For Amazon

DEVICE_PROPERTY_MANUFACTURER ?= "Amlogic"

DEVICE_PROPERTY_WIFI_INTERFACE ?= "wlan0"
DEVICE_PROPERTY_ETHERNET_INTERFACE ?= "eth0"
DEVICE_PROPERTY_VOICEINPUT_SUPPORT ?= "${@bb.utils.contains('DISTRO_FEATURES', 'voiceinput', 'true', 'false', d)}"
DEVICE_PROPERTY_CEC_SUPPORT ?= "${@bb.utils.contains('DISTRO_FEATURES', 'cec', 'true', 'false', d)}"
DEVICE_PROPERTY_WIFI_SUPPORT ?= "${@bb.utils.contains('DISTRO_FEATURES', 'wifi', 'true', 'false', d)}"
DEVICE_PROPERTY_BLUETOOTH_SUPPORT ?= "${@bb.utils.contains('DISTRO_FEATURES', 'bluetooth', 'true', 'false', d)}"
DEVICE_PROPERTY_MIRACLECAST_SUPPORT ?= "${@bb.utils.contains('DISTRO_FEATURES', 'miraclecast', 'true', 'false', d)}"
DEVICE_PROPERTY_TTS_SUPPORT ?= "${@bb.utils.contains('DISTRO_FEATURES', 'tts', 'true', 'false', d)}"
DEVICE_PROPERTY_TV_PLATFORM ?= "${@bb.utils.contains('DISTRO_FEATURES', 'amlogic-tv', 'true', 'false', d)}"
DEVICE_PROPERTY_USE_APPMANAGER ?= "${@bb.utils.contains('DISTRO_FEATURES', 'appmanager', 'true', 'false', d)}"
DEVICE_PROPERTY_LAUNCHER_APPS ?= "${@bb.utils.contains('DISTRO_FEATURES', 'mediaplayer', 'localplayer,', '', d)}"
DEVICE_PROPERTY_LAUNCHER_APPS += "${@bb.utils.contains('DISTRO_FEATURES', 'youtube', 'youtube, youtubetv, youtubekids,', '', d)}"
DEVICE_PROPERTY_LAUNCHER_APPS += "${@bb.utils.contains('DISTRO_FEATURES', 'netflix', 'netflix,', '', d)}"
DEVICE_PROPERTY_LAUNCHER_APPS += "${@bb.utils.contains('DISTRO_FEATURES', 'netflix64b', 'netflix,', '', d)}"
DEVICE_PROPERTY_LAUNCHER_APPS += "${@bb.utils.contains('DISTRO_FEATURES', 'amazon', 'amazon,', '', d)}"
DEVICE_PROPERTY_LAUNCHER_APPS += "${@bb.utils.contains('DISTRO_FEATURES', 'disney', 'disney,', '', d)}"
DEVICE_PROPERTY_STARTUP_APP ?= ""
DEVICE_PROPERTY_LAUNCH_IN_BACKGROUND ?= "${@bb.utils.contains('DISTRO_FEATURES', 'low-memory', '', 'amazon, netflix', d)}"
```

## conf/machine/include/mesona213y_k4.9_32b.inc
```bitbake
# common configuration
require conf/machine/include/amlogic_common.inc
require conf/machine/include/amlogic_32b.inc

PREFERRED_PROVIDER_virtual/gpu ?= "dvalin"
PREFERRED_VERSION_u-boot = "m805%"
PREFERRED_VERSION_linux-meson = "4.9.%"
OVERRIDES .= ":a213y"
```

## conf/machine/include/mesong12b_k5.15_64b.inc
```bitbake
# common configuration
require conf/machine/include/amlogic_common.inc
require conf/machine/include/amlogic_64b.inc
require conf/machine/include/amlogic_k5.15.inc

PREFERRED_VERSION_u-boot = "v2015.%"
#We can't select revsion in external source mode, but use MACHINE define to control it.
PREFERRED_PROVIDER_virtual/gpu ?= "gondul"
PREFERRED_PROVIDER_virtual/lib32-gpu ?= "gondul"
OVERRIDES .= ":w400:g12b:onepass"
```

## conf/machine/include/mesons1a_k5.15_32b.inc
```bitbake
# common configuration
require conf/machine/include/amlogic_common.inc
require conf/machine/include/amlogic_32b.inc
require conf/machine/include/amlogic_k5.15.inc

PREFERRED_VERSION_u-boot = "v2023.%"
#We can't select revsion in external source mode, but use MACHINE define to control it.
PREFERRED_PROVIDER_virtual/gpu ?= "dvalin"
OVERRIDES .= ":s1a:kernel32"
```

## conf/machine/include/mesons4.inc
```bitbake
# common configuration
require conf/machine/include/amlogic_common.inc
require conf/machine/include/amlogic_64b.inc

PREFERRED_VERSION_u-boot = "v2019.%"
#We can't select revsion in external source mode, but use MACHINE define to control it.
PREFERRED_VERSION_linux-meson = "5.4%"
PREFERRED_VERSION_media-modules = "5.4%"
#PREFERRED_PROVIDER_virtual/gpu ?= "dvalin"
OVERRIDES .= ":s4"
```
